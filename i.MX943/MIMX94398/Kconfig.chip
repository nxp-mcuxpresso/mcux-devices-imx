## i.MX943/MIMX94398/Kconfig.rpmsg
```kconfig
# Copyright 2025 NXP
#
# SPDX-License-Identifier: BSD-3-Clause

config RPMSG_A55_M33S
    bool "RPMSG A55 as master, M33S as remote"
    default n
    depends on !USE_TCM_AS_RPMSG_SHMEM

config RPMSG_A55_M70
    bool "RPMSG A55 as master, M70 as remote"
    default n
    depends on !USE_TCM_AS_RPMSG_SHMEM

config RPMSG_A55_M71
    bool "RPMSG A55 as master, M71 as remote"
    default n
    depends on !USE_TCM_AS_RPMSG_SHMEM

    config RPMSG_M33S_M70
        bool "RPMSG M33S as master, M70 as remote"
        default n
        depends on USE_TCM_AS_RPMSG_SHMEM

    config RPMSG_M70_M33S
        bool "RPMSG M70 as master, M33S as remote"
        default n
        depends on USE_TCM_AS_RPMSG_SHMEM
    config RPMSG_M33S_M71
        bool "RPMSG M33S as master, M71 as remote"
        default n
        depends on USE_TCM_AS_RPMSG_SHMEM

    config RPMSG_M71_M33S
        bool "RPMSG M71 as master, M33S as remote"
        default n
        depends on USE_TCM_AS_RPMSG_SHMEM
    config RPMSG_M70_M71
        bool "RPMSG M70 as master, M71 as remote"
        default n
        depends on USE_TCM_AS_RPMSG_SHMEM

    config RPMSG_M71_M70
        bool "RPMSG M71 as master, M70 as remote"
        default n
        depends on USE_TCM_AS_RPMSG_SHMEM

config USE_TCM_AS_RPMSG_SHMEM
    bool "Use TCM as rpmsg share memory"
    default n
```

## i.MX943/MIMX94398/ca55/Kconfig.chip
```kconfig
# Copyright 2025 NXP
#
# SPDX-License-Identifier: BSD-3-Clause

# core related
config MCUX_HW_CORE
    string
    default "ca55"

config MCUX_HW_CORE_CA55
    bool
    default y

config MCUX_HW_CORE_ID
    string
    default "ca55"

config MCUX_HW_CORE_ID_CA55
    bool
    default y

config MCUX_HW_DEVICE_CORE
    string
    default "MIMX94398_ca55"

config MCUX_HW_SOC_SERIES_MIMX
    bool
    default y

# For chipmodel generated files
config MCUX_TOOLCHAIN_LINKER_DEVICE_PREFIX
    string
    default "MIMX94398xxxM" if MCUX_HW_DEVICE_ID_MIMX94398xxxM
    default "MIMX94398xxxJ" if MCUX_HW_DEVICE_ID_MIMX94398xxxJ
    default "MIMX94398xxxE" if MCUX_HW_DEVICE_ID_MIMX94398xxxE
```

## i.MX943/MIMX94398/cm33_core0/Kconfig
```kconfig
# Copyright 2024 NXP
#
# SPDX-License-Identifier: BSD-3-Clause

config MCUX_HW_DEVICE_MIMX94398_CORE_ID_cm33_core0
    bool
    imply MCUX_COMPONENT_driver.cache_xcache
    imply MCUX_COMPONENT_driver.irqsteer_1_soc.cm33_core0
    default y

rsource "Kconfig.chip"
```

## i.MX943/MIMX94398/cm33_core1/Kconfig.chip
```kconfig
# Copyright 2024 NXP
# SPDX-License-Identifier: BSD-3-Clause
# core related
config MCUX_HW_CORE
    string
    default "cm33"

config MCUX_HW_CORE_CM33
    bool
    default y

config MCUX_HW_CORE_ID
    string
    default "cm33_core1"

config MCUX_HW_CORE_ID_CM33_CORE1
    bool
    default y

config MCUX_HW_DEVICE_CORE
    string
    default "MIMX94398_cm33_core1"

config MCUX_HW_FPU
    string
    default "SP_FPU"

config MCUX_HW_FPU_TYPE
    string
    default "fpv5_sp"

config MCUX_HW_FPV5_SP
    bool
    default y

config MCUX_HW_INT_PRIO_BITS
    int
    help
        The value of the option must be equal to the value of the macro "__NVIC_PRIO_BITS" in CMSIS Header files.
    default 4

config MCUX_HW_DSP
    bool
    default y

config MCUX_HW_SAU
    bool
    default y

config MCUX_HW_SOC_SERIES_MIMX
    bool
    default y

# For chipmodel generated files
config MCUX_TOOLCHAIN_LINKER_DEVICE_PREFIX
    string
    default "MIMX94398_cm33_core1" if MCUX_HW_DEVICE_ID_MIMX94398xxxM
    default "MIMX94398_cm33_core1" if MCUX_HW_DEVICE_ID_MIMX94398xxxJ
    default "MIMX94398_cm33_core1" if MCUX_HW_DEVICE_ID_MIMX94398xxxE

config MCUX_TOOLCHAIN_MCUX_STARTUP
    string
    default "mimx9494_cm33_core1"

# Toolchain related

config MCUX_TOOLCHAIN_IAR_CPU_IDENTIFIER
    string
    default "MIMX94398xxxM_cm33_core1" if MCUX_HW_DEVICE_ID_MIMX94398xxxM
    default "MIMX94398xxxJ_cm33_core1" if MCUX_HW_DEVICE_ID_MIMX94398xxxJ
    default "MIMX94398xxxE_cm33_core1" if MCUX_HW_DEVICE_ID_MIMX94398xxxE

config MCUX_TOOLCHAIN_MDK_CPU_IDENTIFIER
    string
    default "MIMX94398DVKM:cm33_core1" if MCUX_HW_DEVICE_PART_MIMX94398DVKM
    default "MIMX94398DVMM:cm33_core1" if MCUX_HW_DEVICE_PART_MIMX94398DVMM
    default "MIMX94398CVKM:cm33_core1" if MCUX_HW_DEVICE_PART_MIMX94398CVKM
    default "MIMX94398CVMM:cm33_core1" if MCUX_HW_DEVICE_PART_MIMX94398CVMM
    default "MIMX94398XVKM:cm33_core1" if MCUX_HW_DEVICE_PART_MIMX94398XVKM
    default "MIMX94398XVMM:cm33_core1" if MCUX_HW_DEVICE_PART_MIMX94398XVMM
    default "MIMX94398AVKM:cm33_core1" if MCUX_HW_DEVICE_PART_MIMX94398AVKM
    default "MIMX94398AVMM:cm33_core1" if MCUX_HW_DEVICE_PART_MIMX94398AVMM
    default "MIMX94398DVKJ:cm33_core1" if MCUX_HW_DEVICE_PART_MIMX94398DVKJ
    default "MIMX94398DVMJ:cm33_core1" if MCUX_HW_DEVICE_PART_MIMX94398DVMJ
    default "MIMX94398CVKJ:cm33_core1" if MCUX_HW_DEVICE_PART_MIMX94398CVKJ
    default "MIMX94398CVMJ:cm33_core1" if MCUX_HW_DEVICE_PART_MIMX94398CVMJ
    default "MIMX94398XVKJ:cm33_core1" if MCUX_HW_DEVICE_PART_MIMX94398XVKJ
    default "MIMX94398XVMJ:cm33_core1" if MCUX_HW_DEVICE_PART_MIMX94398XVMJ
    default "MIMX94398AVKJ:cm33_core1" if MCUX_HW_DEVICE_PART_MIMX94398AVKJ
    default "MIMX94398AVMJ:cm33_core1" if MCUX_HW_DEVICE_PART_MIMX94398AVMJ
    default "MIMX94398DVKE:cm33_core1" if MCUX_HW_DEVICE_PART_MIMX94398DVKE
    default "MIMX94398DVME:cm33_core1" if MCUX_HW_DEVICE_PART_MIMX94398DVME
    default "MIMX94398CVKE:cm33_core1" if MCUX_HW_DEVICE_PART_MIMX94398CVKE
    default "MIMX94398CVME:cm33_core1" if MCUX_HW_DEVICE_PART_MIMX94398CVME
    default "MIMX94398XVKE:cm33_core1" if MCUX_HW_DEVICE_PART_MIMX94398XVKE
    default "MIMX94398XVME:cm33_core1" if MCUX_HW_DEVICE_PART_MIMX94398XVME
    default "MIMX94398AVKE:cm33_core1" if MCUX_HW_DEVICE_PART_MIMX94398AVKE
    default "MIMX94398AVME:cm33_core1" if MCUX_HW_DEVICE_PART_MIMX94398AVME
```

## i.MX943/MIMX94398/cm7_core1/Kconfig
```kconfig
# Copyright 2024 NXP
# SPDX-License-Identifier: BSD-3-Clause

config MCUX_HW_DEVICE_MIMX94398_CORE_ID_cm7_core1
    bool
    imply MCUX_COMPONENT_driver.cache_armv7_m7
    imply MCUX_COMPONENT_driver.irqsteer_1_soc.cm7_core1
    default y

rsource "Kconfig.chip"
```

## i.MX943/MIMX94398/cm7_core1/Kconfig.chip
```kconfig
# Copyright 2024 NXP
# SPDX-License-Identifier: BSD-3-Clause
# core related
config MCUX_HW_CORE
    string
    default "cm7f"

config MCUX_HW_CORE_CM7F
    bool
    default y

config MCUX_HW_CORE_ID
    string
    default "cm7_core1"

config MCUX_HW_CORE_ID_CM7_CORE1
    bool
    default y

config MCUX_HW_DEVICE_CORE
    string
    default "MIMX94398_cm7_core1"

config MCUX_HW_FPU
    string
    default "DP_FPU"

config MCUX_HW_FPU_TYPE
    string
    default "fpv5_dp"

config MCUX_HW_FPV5_DP
    bool
    default y

config MCUX_HW_INT_PRIO_BITS
    int
    default 4

config MCUX_HW_SOC_SERIES_MIMX
    bool
    default y

# For chipmodel generated files
config MCUX_TOOLCHAIN_LINKER_DEVICE_PREFIX
    string
    default "MIMX94398_cm7_core1" if MCUX_HW_DEVICE_ID_MIMX94398xxxM
    default "MIMX94398_cm7_core1" if MCUX_HW_DEVICE_ID_MIMX94398xxxJ
    default "MIMX94398_cm7_core1" if MCUX_HW_DEVICE_ID_MIMX94398xxxE

config MCUX_TOOLCHAIN_MCUX_STARTUP
    string
    default "mimx9494_cm7_core1"

# Toolchain related

config MCUX_TOOLCHAIN_IAR_CPU_IDENTIFIER
    string
    default "MIMX94398xxxM_cm7_core1" if MCUX_HW_DEVICE_ID_MIMX94398xxxM
    default "MIMX94398xxxJ_cm7_core1" if MCUX_HW_DEVICE_ID_MIMX94398xxxJ
    default "MIMX94398xxxE_cm7_core1" if MCUX_HW_DEVICE_ID_MIMX94398xxxE

config MCUX_TOOLCHAIN_MDK_CPU_IDENTIFIER
    string
    default "MIMX94398DVKM:cm7_core1" if MCUX_HW_DEVICE_PART_MIMX94398DVKM
    default "MIMX94398DVMM:cm7_core1" if MCUX_HW_DEVICE_PART_MIMX94398DVMM
    default "MIMX94398CVKM:cm7_core1" if MCUX_HW_DEVICE_PART_MIMX94398CVKM
    default "MIMX94398CVMM:cm7_core1" if MCUX_HW_DEVICE_PART_MIMX94398CVMM
    default "MIMX94398XVKM:cm7_core1" if MCUX_HW_DEVICE_PART_MIMX94398XVKM
    default "MIMX94398XVMM:cm7_core1" if MCUX_HW_DEVICE_PART_MIMX94398XVMM
    default "MIMX94398AVKM:cm7_core1" if MCUX_HW_DEVICE_PART_MIMX94398AVKM
    default "MIMX94398AVMM:cm7_core1" if MCUX_HW_DEVICE_PART_MIMX94398AVMM
    default "MIMX94398DVKJ:cm7_core1" if MCUX_HW_DEVICE_PART_MIMX94398DVKJ
    default "MIMX94398DVMJ:cm7_core1" if MCUX_HW_DEVICE_PART_MIMX94398DVMJ
    default "MIMX94398CVKJ:cm7_core1" if MCUX_HW_DEVICE_PART_MIMX94398CVKJ
    default "MIMX94398CVMJ:cm7_core1" if MCUX_HW_DEVICE_PART_MIMX94398CVMJ
    default "MIMX94398XVKJ:cm7_core1" if MCUX_HW_DEVICE_PART_MIMX94398XVKJ
    default "MIMX94398XVMJ:cm7_core1" if MCUX_HW_DEVICE_PART_MIMX94398XVMJ
    default "MIMX94398AVKJ:cm7_core1" if MCUX_HW_DEVICE_PART_MIMX94398AVKJ
    default "MIMX94398AVMJ:cm7_core1" if MCUX_HW_DEVICE_PART_MIMX94398AVMJ
    default "MIMX94398DVKE:cm7_core1" if MCUX_HW_DEVICE_PART_MIMX94398DVKE
    default "MIMX94398DVME:cm7_core1" if MCUX_HW_DEVICE_PART_MIMX94398DVME
    default "MIMX94398CVKE:cm7_core1" if MCUX_HW_DEVICE_PART_MIMX94398CVKE
    default "MIMX94398CVME:cm7_core1" if MCUX_HW_DEVICE_PART_MIMX94398CVME
    default "MIMX94398XVKE:cm7_core1" if MCUX_HW_DEVICE_PART_MIMX94398XVKE
    default "MIMX94398XVME:cm7_core1" if MCUX_HW_DEVICE_PART_MIMX94398XVME
    default "MIMX94398AVKE:cm7_core1" if MCUX_HW_DEVICE_PART_MIMX94398AVKE
    default "MIMX94398AVME:cm7_core1" if MCUX_HW_DEVICE_PART_MIMX94398AVME
```

## i.MX943/MIMX94398/drivers/Kconfig
```kconfig
# Copyright 2024 NXP
#
# SPDX-License-Identifier: BSD-3-Clause
rsource "${core_id}/Kconfig"

menu "Device specific drivers configuration"

    config MCUX_COMPONENT_driver.elec_spec
         bool "elec_spec"
         default y

    config MCUX_COMPONENT_driver.reset
         bool "reset"
         default y

    config MCUX_COMPONENT_driver.trdc_soc
         bool "trdc_soc"
         default n

    config MCUX_COMPONENT_driver.clock
         bool "clock"
         default y

    config MCUX_COMPONENT_driver.edma_soc
         bool "edma_soc"
         depends on MCUX_COMPONENT_driver.edma4
         default y

    config MCUX_COMPONENT_driver.iomuxc
         bool "iomuxc"
         default y

    config MCUX_COMPONENT_driver.supply
         bool "supply"
         default n

    config MCUX_COMPONENT_driver.cpu
         bool "cpu"
         default n

    config MCUX_COMPONENT_driver.memory
         bool "memory"
         default y

    config MCUX_COMPONENT_driver.power
         bool "power"
         default y

    config MCUX_COMPONENT_driver.ccm
         bool "ccm"
         default n

    config MCUX_COMPONENT_driver.src1
         bool "src1"
         default n

    config MCUX_COMPONENT_driver.fro
         bool "fro"
         default n
endmenu
```

## i.MX943/MIMX94398/drivers/ca55/Kconfig
```kconfig
# Copyright 2026 NXP
#
# SPDX-License-Identifier: BSD-3-Clause

config MCUX_HAS_COMPONENT_driver.irqsteer_1_soc.ca55
    bool
    default y if MCUX_HW_IP_DriverType_IRQSTEER_1

config MCUX_COMPONENT_driver.irqsteer_1_soc.ca55
    bool "IRQSTEER SOC driver for CA55"
    depends on MCUX_HAS_COMPONENT_driver.irqsteer_1_soc.ca55
    select MCUX_COMPONENT_driver.irqsteer_1
    help
        Enable IRQSTEER SOC driver for Cortex-A55 core.
        This driver routes interrupts from peripherals (like EDMA4)
        through the IRQSTEERA55 instance to the CA55 GIC.
```

## i.MX943/MIMX94398/drivers/cm33_core0/Kconfig
```kconfig
# Copyright 2025 NXP
#
# SPDX-License-Identifier: BSD-3-Clause
menu "Device core specific drivers configuration"
    config MCUX_COMPONENT_driver.irqsteer_1_soc.cm33_core0
         bool "Use irqsteer_1 soc specific driver"
endmenu
```

## i.MX95/MIMX9586/drivers/Kconfig
```kconfig
# Copyright 2025 NXP
# All rights reserved.
#
# SPDX-License-Identifier: BSD-3-Clause

rsource "../../../i.MX95/MIMX9596/drivers/Kconfig"
```
