## i.MX952/MIMX9529/Kconfig.chip
```kconfig
# Copyright 2025 NXP
# All rights reserved.
#
# SPDX-License-Identifier: BSD-3-Clause

# device related
config MCUX_HW_DEVICE_ID_MIMX9529xxxxx
    bool

choice
    prompt "Device MIMX9529 Part"
    config MCUX_HW_DEVICE_PART_MIMX9529xxVZx
    bool "MIMX9529xxVZx"
    select MCUX_HW_DEVICE_ID_MIMX9529xxxxx
    config MCUX_HW_DEVICE_PART_MIMX9529xxVYx
    bool "MIMX9529xxVYx"
    select MCUX_HW_DEVICE_ID_MIMX9529xxxxx
    config MCUX_HW_DEVICE_PART_MIMX9529xxVTx
    bool "MIMX9529xxVTx"
    select MCUX_HW_DEVICE_ID_MIMX9529xxxxx
endchoice

config MCUX_HW_DEVICE_ID
    string
    default "MIMX9529xxxxx" if MCUX_HW_DEVICE_ID_MIMX9529xxxxx

config MCUX_HW_DEVICE_PART
    string
    default "MIMX9529xxVZx" if MCUX_HW_DEVICE_PART_MIMX9529xxVZx
    default "MIMX9529xxVYx" if MCUX_HW_DEVICE_PART_MIMX9529xxVYx
    default "MIMX9529xxVTx" if MCUX_HW_DEVICE_PART_MIMX9529xxVTx
 
# ip information
config MCUX_HW_IP_DriverType_ATU
    bool
    default y
    depends on MCUX_HW_DEVICE_ID_MIMX9529xxxxx
config MCUX_HW_IP_DriverType_ASRC
    bool
    default y
    depends on MCUX_HW_DEVICE_ID_MIMX9529xxxxx
config MCUX_HW_IP_DriverType_AUDMIX
    bool
    default y
    depends on MCUX_HW_DEVICE_ID_MIMX9529xxxxx
config MCUX_HW_IP_DriverType_AXBS
    bool
    default y
    depends on MCUX_HW_DEVICE_ID_MIMX9529xxxxx
config MCUX_HW_IP_DriverType_BBNSM
    bool
    default y
    depends on MCUX_HW_DEVICE_ID_MIMX9529xxxxx
config MCUX_HW_IP_DriverType_BLK_CTRL_CAMERAMIX
    bool
    default y
    depends on MCUX_HW_DEVICE_ID_MIMX9529xxxxx
config MCUX_HW_IP_DriverType_BLK_CTRL_NS_AONMIX
    bool
    default y
    depends on MCUX_HW_DEVICE_ID_MIMX9529xxxxx
config MCUX_HW_IP_DriverType_BLK_CTRL_S_AONMIX
    bool
    default y
    depends on MCUX_HW_DEVICE_ID_MIMX9529xxxxx
config MCUX_HW_IP_DriverType_BLK_CTRL_WAKEUPMIX
    bool
    default y
    depends on MCUX_HW_DEVICE_ID_MIMX9529xxxxx
config MCUX_HW_IP_DriverType_CACHEC
    bool
    default y
    depends on MCUX_HW_DEVICE_ID_MIMX9529xxxxx
config MCUX_HW_IP_DriverType_CMU
    bool
    default y
    depends on MCUX_HW_DEVICE_ID_MIMX9529xxxxx
config MCUX_HW_IP_DriverType_DDRC
    bool
    default y
    depends on MCUX_HW_DEVICE_ID_MIMX9529xxxxx
config MCUX_HW_IP_DriverType_DISPLAY_SEERIS
    bool
    default y
    depends on MCUX_HW_DEVICE_ID_MIMX9529xxxxx
config MCUX_HW_IP_DriverType_DMA_CRC
    bool
    default y
    depends on MCUX_HW_DEVICE_ID_MIMX9529xxxxx
config MCUX_HW_IP_DriverType_D_IP_ROBLK
    bool
    default y
    depends on MCUX_HW_DEVICE_ID_MIMX9529xxxxx
config MCUX_HW_IP_DriverType_EDMA3
    bool
    default y
    depends on MCUX_HW_DEVICE_ID_MIMX9529xxxxx
config MCUX_HW_IP_DriverType_EDMA5
    bool
    default y
    depends on MCUX_HW_DEVICE_ID_MIMX9529xxxxx
config MCUX_HW_IP_DriverType_EIM
    bool
    default y
    depends on MCUX_HW_DEVICE_ID_MIMX9529xxxxx
config MCUX_HW_IP_DriverType_ERM
    bool
    default y
    depends on MCUX_HW_DEVICE_ID_MIMX9529xxxxx
config MCUX_HW_IP_DriverType_FLEXCAN
    bool
    default y
    depends on MCUX_HW_DEVICE_ID_MIMX9529xxxxx
config MCUX_HW_IP_DriverType_FLEXIO
    bool
    default y
    depends on MCUX_HW_DEVICE_ID_MIMX9529xxxxx
config MCUX_HW_IP_DriverType_FRO
    bool
    default y
    depends on MCUX_HW_DEVICE_ID_MIMX9529xxxxx
config MCUX_HW_IP_DriverType_INTM
    bool
    default y
    depends on MCUX_HW_DEVICE_ID_MIMX9529xxxxx
config MCUX_HW_IP_DriverType_IRQSTEER_1
    bool
    default y
    depends on MCUX_HW_DEVICE_ID_MIMX9529xxxxx
config MCUX_HW_IP_DriverType_ISI
    bool
    default y
    depends on MCUX_HW_DEVICE_ID_MIMX9529xxxxx
config MCUX_HW_IP_DriverType_JPEG_DECODER
    bool
    default y
    depends on MCUX_HW_DEVICE_ID_MIMX9529xxxxx
config MCUX_HW_IP_DriverType_JPEG_ENCODER
    bool
    default y
    depends on MCUX_HW_DEVICE_ID_MIMX9529xxxxx
config MCUX_HW_IP_DriverType_JPGDECWRP
    bool
    default y
    depends on MCUX_HW_DEVICE_ID_MIMX9529xxxxx
config MCUX_HW_IP_DriverType_JPGENCWRP
    bool
    default y
    depends on MCUX_HW_DEVICE_ID_MIMX9529xxxxx
config MCUX_HW_IP_DriverType_JTAGC
    bool
    default y
    depends on MCUX_HW_DEVICE_ID_MIMX9529xxxxx
config MCUX_HW_IP_DriverType_I3C
    bool
    default y
    depends on MCUX_HW_DEVICE_ID_MIMX9529xxxxx
config MCUX_HW_IP_DriverType_LPI2C
    bool
    default y
    depends on MCUX_HW_DEVICE_ID_MIMX9529xxxxx
config MCUX_HW_IP_DriverType_LPIT
    bool
    default y
    depends on MCUX_HW_DEVICE_ID_MIMX9529xxxxx
config MCUX_HW_IP_DriverType_LPSPI
    bool
    default y
    depends on MCUX_HW_DEVICE_ID_MIMX9529xxxxx
config MCUX_HW_IP_DriverType_LPTMR
    bool
    default y
    depends on MCUX_HW_DEVICE_ID_MIMX9529xxxxx
config MCUX_HW_IP_DriverType_LPUART
    bool
    default y
    depends on MCUX_HW_DEVICE_ID_MIMX9529xxxxx
config MCUX_HW_IP_DriverType_MCM
    bool
    default y
    depends on MCUX_HW_DEVICE_ID_MIMX9529xxxxx
config MCUX_HW_IP_DriverType_MDM_AP
    bool
    default y
    depends on MCUX_HW_DEVICE_ID_MIMX9529xxxxx
config MCUX_HW_IP_DriverType_MEMORY
    bool
    default y
    depends on MCUX_HW_DEVICE_ID_MIMX9529xxxxx
config MCUX_HW_IP_DriverType_MQS
    bool
    default y
    depends on MCUX_HW_DEVICE_ID_MIMX9529xxxxx
config MCUX_HW_IP_DriverType_MSGINTR
    bool
    default y
    depends on MCUX_HW_DEVICE_ID_MIMX9529xxxxx
config MCUX_HW_IP_DriverType_MU_1
    bool
    default y
    depends on MCUX_HW_DEVICE_ID_MIMX9529xxxxx
config MCUX_HW_IP_DriverType_NETC
    bool
    default y
    depends on MCUX_HW_DEVICE_ID_MIMX9529xxxxx
config MCUX_HW_IP_DriverType_NEUTRON
    bool
    default y
    depends on MCUX_HW_DEVICE_ID_MIMX9529xxxxx
config MCUX_HW_IP_DriverType_PDM
    bool
    default y
    depends on MCUX_HW_DEVICE_ID_MIMX9529xxxxx
config MCUX_HW_IP_DriverType_RGPIO
    bool
    default y
    depends on MCUX_HW_DEVICE_ID_MIMX9529xxxxx
config MCUX_HW_IP_DriverType_ROMC
    bool
    default y
    depends on MCUX_HW_DEVICE_ID_MIMX9529xxxxx
config MCUX_HW_IP_DriverType_S3MU
    bool
    default y
    depends on MCUX_HW_DEVICE_ID_MIMX9529xxxxx
config MCUX_HW_IP_DriverType_SAI
    bool
    default y
    depends on MCUX_HW_DEVICE_ID_MIMX9529xxxxx
config MCUX_HW_IP_DriverType_SAR_ADC
    bool
    default y
    depends on MCUX_HW_DEVICE_ID_MIMX9529xxxxx
config MCUX_HW_IP_DriverType_SEMA42
    bool
    default y
    depends on MCUX_HW_DEVICE_ID_MIMX9529xxxxx
config MCUX_HW_IP_DriverType_SFA
    bool
    default y
    depends on MCUX_HW_DEVICE_ID_MIMX9529xxxxx
config MCUX_HW_IP_DriverType_STIMER_tmr
    bool
    default y
    depends on MCUX_HW_DEVICE_ID_MIMX9529xxxxx
config MCUX_HW_IP_DriverType_TEMPSENSOR
    bool
    default y
    depends on MCUX_HW_DEVICE_ID_MIMX9529xxxxx
config MCUX_HW_IP_DriverType_TPM
    bool
    default y
    depends on MCUX_HW_DEVICE_ID_MIMX9529xxxxx
config MCUX_HW_IP_DriverType_TRDC
    bool
    default y
    depends on MCUX_HW_DEVICE_ID_MIMX9529xxxxx
config MCUX_HW_IP_DriverType_TRGMUX
    bool
    default y
    depends on MCUX_HW_DEVICE_ID_MIMX9529xxxxx
config MCUX_HW_IP_DriverType_TSTMR
    bool
    default y
    depends on MCUX_HW_DEVICE_ID_MIMX9529xxxxx
config MCUX_HW_IP_DriverType_XCACHE
    bool
    default y
    depends on MCUX_HW_DEVICE_ID_MIMX9529xxxxx
config MCUX_HW_IP_DriverType_XSPI
    bool
    default y
    depends on MCUX_HW_DEVICE_ID_MIMX9529xxxxx
config MCUX_HW_IP_DriverType_USBPHY
    bool
    default y
    depends on MCUX_HW_DEVICE_ID_MIMX9529xxxxx
config MCUX_HW_IP_DriverType_USB_HOST_DEVICE_EHCI
    bool
    default y
    depends on MCUX_HW_DEVICE_ID_MIMX9529xxxxx
config MCUX_HW_IP_DriverType_bbsmmix
    bool
    default y
    depends on MCUX_HW_DEVICE_ID_MIMX9529xxxxx
config MCUX_HW_IP_DriverType_blk_ctrl_ddrmix
    bool
    default y
    depends on MCUX_HW_DEVICE_ID_MIMX9529xxxxx
config MCUX_HW_IP_DriverType_d_ip_imx95_ccm_syn
    bool
    default y
    depends on MCUX_HW_DEVICE_ID_MIMX9529xxxxx
config MCUX_HW_IP_DriverType_ieprc_ierb
    bool
    default y
    depends on MCUX_HW_DEVICE_ID_MIMX9529xxxxx
config MCUX_HW_IP_DriverType_ieprc_pci
    bool
    default y
    depends on MCUX_HW_DEVICE_ID_MIMX9529xxxxx
config MCUX_HW_IP_DriverType_ieprc_prb
    bool
    default y
    depends on MCUX_HW_DEVICE_ID_MIMX9529xxxxx
config MCUX_HW_IP_DriverType_neutrons
    bool
    default y
    depends on MCUX_HW_DEVICE_ID_MIMX9529xxxxx
config MCUX_HW_IP_DriverType_MIPI_CSI2_1
    bool
    default y
    depends on MCUX_HW_DEVICE_ID_MIMX9529xxxxx
config MCUX_HW_IP_DriverType_MIPI_DSI2
    bool
    default y
    depends on MCUX_HW_DEVICE_ID_MIMX9529xxxxx
config MCUX_HW_IP_DriverType_LDB_1
    bool
    default y
    depends on MCUX_HW_DEVICE_ID_MIMX9529xxxxx
```

## i.MX952/MIMX9529/cm33/Kconfig
```kconfig
# Copyright 2026 NXP
#
# SPDX-License-Identifier: BSD-3-Clause

config MCUX_HW_DEVICE_MIMX9529_CORE_ID_cm33
    bool
    default y

rsource "Kconfig.chip"
```

## i.MX952/MIMX9529/cm33/Kconfig.chip
```kconfig
# Copyright 2026 NXP
#
# SPDX-License-Identifier: BSD-3-Clause

# core related
config MCUX_HW_CORE
    string
    default "cm33"

config MCUX_HW_CORE_CM33
    bool
    default y

config MCUX_HW_CORE_ID
    string
    default "cm33"

config MCUX_HW_CORE_ID_CM33
    bool
    default y

config MCUX_HW_DEVICE_CORE
    string
    default "MIMX9529_cm33"

config MCUX_HW_FPU
    string
    default "SP_FPU"

config MCUX_HW_FPU_TYPE
    string
    default "fpv5_sp"

config MCUX_HW_FPV5_SP
    bool
    default y

config MCUX_HW_INT_PRIO_BITS
    int
    default 4

config MCUX_HW_DSP
    bool
    default y

config MCUX_HW_SAU
    bool
    default y

config MCUX_HW_SOC_SERIES_MIMX
    bool
    default y

# For chipmodel generated files
config MCUX_TOOLCHAIN_LINKER_DEVICE_PREFIX
    string
    default "MIMX9529_cm33" if MCUX_HW_DEVICE_ID_MIMX9529xxxxx

config MCUX_TOOLCHAIN_MCUX_STARTUP
    string
    default "mimx9529_cm33"

# Toolchain related
config MCUX_TOOLCHAIN_IAR_CPU_IDENTIFIER
    string
    default "MIMX9529_M33" if MCUX_HW_DEVICE_ID_MIMX9529xxxxx

config MCUX_TOOLCHAIN_MDK_CPU_IDENTIFIER
    string
    default "MIMX9529xxVZx:cm33" if MCUX_HW_DEVICE_PART_MIMX9529xxVZx
    default "MIMX9529xxVTx:cm33" if MCUX_HW_DEVICE_PART_MIMX9529xxVTx
```

## i.MX952/MIMX9529/cm7/Kconfig.chip
```kconfig
# Copyright 2026 NXP
#
# SPDX-License-Identifier: BSD-3-Clause

# core related
config MCUX_HW_CORE
    string
    default "cm7f"

config MCUX_HW_CORE_CM7F
    bool
    default y

config MCUX_HW_CORE_ID
    string
    default "cm7"

config MCUX_HW_CORE_ID_CM7
    bool
    default y

config MCUX_HW_DEVICE_CORE
    string
    default "MIMX9529_cm7"

config MCUX_HW_FPU
    string
    default "DP_FPU"

config MCUX_HW_FPU_TYPE
    string
    default "fpv5_dp"

config MCUX_HW_FPV5_DP
    bool
    default y

config MCUX_HW_INT_PRIO_BITS
    int
    default 4

config MCUX_HW_SOC_SERIES_MIMX
    bool
    default y

# For chipmodel generated files
config MCUX_TOOLCHAIN_LINKER_DEVICE_PREFIX
    string
    default "MIMX9529_cm7" if MCUX_HW_DEVICE_ID_MIMX9529xxxxx

config MCUX_TOOLCHAIN_MCUX_STARTUP
    string
    default "mimx9529_cm7"

# Toolchain related
config MCUX_TOOLCHAIN_IAR_CPU_IDENTIFIER
    string
    default "MIMX9529_M7" if MCUX_HW_DEVICE_ID_MIMX9529xxxxx

config MCUX_TOOLCHAIN_MDK_CPU_IDENTIFIER
    string
    default "MIMX9529xxVZx:cm7" if MCUX_HW_DEVICE_PART_MIMX9529xxVZx
    default "MIMX9529xxVTx:cm7" if MCUX_HW_DEVICE_PART_MIMX9529xxVTx
```

## i.MX952/MIMX9529/drivers/Kconfig
```kconfig
# Copyright 2024 NXP
# All rights reserved.
#
# SPDX-License-Identifier: BSD-3-Clause

menu "Device specific drivers configuration"

    config MCUX_COMPONENT_driver.clock
         bool "clock"
         default y

    config MCUX_COMPONENT_driver.edma_soc
         bool "edma_soc"

    config MCUX_COMPONENT_driver.iomuxc
         bool "iomuxc"
         default y

    config MCUX_COMPONENT_driver.power
         bool "power"
         default y

    config MCUX_COMPONENT_driver.memory
         bool "memory"
         default y

    config MCUX_COMPONENT_driver.sentinel
         bool "sentinel"

    config MCUX_COMPONENT_driver.trdc_soc
         bool "trdc_soc"

    config MCUX_COMPONENT_driver.irqsteer_1_soc
         bool "Use irqsteer_1 soc specific driver"

endmenu
```
