## i.MX91/MIMX9111/Kconfig.chip
```kconfig
# Copyright 2025 NXP
#
# SPDX-License-Identifier: BSD-3-Clause

# device related

config MCUX_HW_DEVICE_ID_MIMX9111xxxxx
    bool

choice MCUX_HW_DEVICE_PART_MIMX9111
    prompt "Device MIMX9111 Part"
    config MCUX_HW_DEVICE_PART_MIMX9111CVXXJ
    bool "MIMX9111CVXXJ"
    select MCUX_HW_DEVICE_ID_MIMX9111xxxxx
    config MCUX_HW_DEVICE_PART_MIMX9111DVXXJ
    bool "MIMX9111DVXXJ"
    select MCUX_HW_DEVICE_ID_MIMX9111xxxxx
endchoice

config MCUX_HW_DEVICE_ID
    string
    default "MIMX9111xxxxx" if MCUX_HW_DEVICE_ID_MIMX9111xxxxx

config MCUX_HW_DEVICE_PART
    string
    default "MIMX9111CVXXJ" if MCUX_HW_DEVICE_PART_MIMX9111CVXXJ
    default "MIMX9111DVXXJ" if MCUX_HW_DEVICE_PART_MIMX9111DVXXJ

# ip information
config MCUX_HW_IP_DriverType_
    bool
    default y
    depends on MCUX_HW_DEVICE_ID_MIMX9111xxxxx

config MCUX_HW_IP_DriverType_AXBS
    bool
    default y
    depends on MCUX_HW_DEVICE_ID_MIMX9111xxxxx

config MCUX_HW_IP_DriverType_BLK_CTRL_NIC_WRAPPER
    bool
    default y
    depends on MCUX_HW_DEVICE_ID_MIMX9111xxxxx

config MCUX_HW_IP_DriverType_BLK_CTRL_WAKEUPMIX
    bool
    default y
    depends on MCUX_HW_DEVICE_ID_MIMX9111xxxxx

config MCUX_HW_IP_DriverType_CoreDebug
    bool
    default y
    depends on MCUX_HW_DEVICE_ID_MIMX9111xxxxx

config MCUX_HW_IP_DriverType_DDR
    bool
    default y
    depends on MCUX_HW_DEVICE_ID_MIMX9111xxxxx

config MCUX_HW_IP_DriverType_D_IP_MX9DUAL_CCM
    bool
    default y
    depends on MCUX_HW_DEVICE_ID_MIMX9111xxxxx

config MCUX_HW_IP_DriverType_EDMA3
    bool
    default y
    depends on MCUX_HW_DEVICE_ID_MIMX9111xxxxx

config MCUX_HW_IP_DriverType_ENET
    bool
    default y
    depends on MCUX_HW_DEVICE_ID_MIMX9111xxxxx

config MCUX_HW_IP_DriverType_ENET_QOS
    bool
    default y
    depends on MCUX_HW_DEVICE_ID_MIMX9111xxxxx

config MCUX_HW_IP_DriverType_ETM
    bool
    default y
    depends on MCUX_HW_DEVICE_ID_MIMX9111xxxxx

config MCUX_HW_IP_DriverType_FLEXCAN
    bool
    default y
    depends on MCUX_HW_DEVICE_ID_MIMX9111xxxxx

config MCUX_HW_IP_DriverType_FLEXSPI
    bool
    default y
    depends on MCUX_HW_DEVICE_ID_MIMX9111xxxxx

config MCUX_HW_IP_DriverType_I3C
    bool
    default y
    depends on MCUX_HW_DEVICE_ID_MIMX9111xxxxx

config MCUX_HW_IP_DriverType_ISI
    bool
    default y
    depends on MCUX_HW_DEVICE_ID_MIMX9111xxxxx

config MCUX_HW_IP_DriverType_JTAGC
    bool
    default y
    depends on MCUX_HW_DEVICE_ID_MIMX9111xxxxx

config MCUX_HW_IP_DriverType_LCDIFV3
    bool
    default y
    depends on MCUX_HW_DEVICE_ID_MIMX9111xxxxx

config MCUX_HW_IP_DriverType_LPI2C
    bool
    default y
    depends on MCUX_HW_DEVICE_ID_MIMX9111xxxxx

config MCUX_HW_IP_DriverType_LPIT
    bool
    default y
    depends on MCUX_HW_DEVICE_ID_MIMX9111xxxxx

config MCUX_HW_IP_DriverType_LPSPI
    bool
    default y
    depends on MCUX_HW_DEVICE_ID_MIMX9111xxxxx

config MCUX_HW_IP_DriverType_LPTMR
    bool
    default y
    depends on MCUX_HW_DEVICE_ID_MIMX9111xxxxx

config MCUX_HW_IP_DriverType_LPUART
    bool
    default y
    depends on MCUX_HW_DEVICE_ID_MIMX9111xxxxx

config MCUX_HW_IP_DriverType_MEMORY
    bool
    default y
    depends on MCUX_HW_DEVICE_ID_MIMX9111xxxxx

config MCUX_HW_IP_DriverType_MQS
    bool
    default y
    depends on MCUX_HW_DEVICE_ID_MIMX9111xxxxx

config MCUX_HW_IP_DriverType_OTFAD
    bool
    default y
    depends on MCUX_HW_DEVICE_ID_MIMX9111xxxxx

config MCUX_HW_IP_DriverType_PDM
    bool
    default y
    depends on MCUX_HW_DEVICE_ID_MIMX9111xxxxx

config MCUX_HW_IP_DriverType_RGPIO
    bool
    default y
    depends on MCUX_HW_DEVICE_ID_MIMX9111xxxxx

config MCUX_HW_IP_DriverType_S3MUA
    bool
    default y
    depends on MCUX_HW_DEVICE_ID_MIMX9111xxxxx

config MCUX_HW_IP_DriverType_SAI
    bool
    default y
    depends on MCUX_HW_DEVICE_ID_MIMX9111xxxxx

config MCUX_HW_IP_DriverType_SEMA42
    bool
    default y
    depends on MCUX_HW_DEVICE_ID_MIMX9111xxxxx

config MCUX_HW_IP_DriverType_SPDIF
    bool
    default y
    depends on MCUX_HW_DEVICE_ID_MIMX9111xxxxx

config MCUX_HW_IP_DriverType_SYS_CTR_COMPARE
    bool
    default y
    depends on MCUX_HW_DEVICE_ID_MIMX9111xxxxx

config MCUX_HW_IP_DriverType_SYS_CTR_CONTROL
    bool
    default y
    depends on MCUX_HW_DEVICE_ID_MIMX9111xxxxx

config MCUX_HW_IP_DriverType_SYS_CTR_READ
    bool
    default y
    depends on MCUX_HW_DEVICE_ID_MIMX9111xxxxx

config MCUX_HW_IP_DriverType_SysTick
    bool
    default y
    depends on MCUX_HW_DEVICE_ID_MIMX9111xxxxx

config MCUX_HW_IP_DriverType_TPIU
    bool
    default y
    depends on MCUX_HW_DEVICE_ID_MIMX9111xxxxx

config MCUX_HW_IP_DriverType_TPM
    bool
    default y
    depends on MCUX_HW_DEVICE_ID_MIMX9111xxxxx

config MCUX_HW_IP_DriverType_TRDC_1
    bool
    default y
    depends on MCUX_HW_DEVICE_ID_MIMX9111xxxxx

config MCUX_HW_IP_DriverType_TRGMUX
    bool
    default y
    depends on MCUX_HW_DEVICE_ID_MIMX9111xxxxx

config MCUX_HW_IP_DriverType_TSTMR
    bool
    default y
    depends on MCUX_HW_DEVICE_ID_MIMX9111xxxxx

config MCUX_HW_IP_DriverType_USDHC
    bool
    default y
    depends on MCUX_HW_DEVICE_ID_MIMX9111xxxxx

config MCUX_HW_IP_DriverType_WDOG32
    bool
    default y
    depends on MCUX_HW_DEVICE_ID_MIMX9111xxxxx

config MCUX_HW_IP_DriverType_blk_ctrl_ddrmix
    bool
    default y
    depends on MCUX_HW_DEVICE_ID_MIMX9111xxxxx

config MCUX_HW_IP_DriverType_blk_ctrl_ns_aonmix
    bool
    default y
    depends on MCUX_HW_DEVICE_ID_MIMX9111xxxxx

config MCUX_HW_IP_DriverType_blk_ctrl_s_aonmix
    bool
    default y
    depends on MCUX_HW_DEVICE_ID_MIMX9111xxxxx

config MCUX_HW_IP_DriverType_iomuxc
    bool
    default y
    depends on MCUX_HW_DEVICE_ID_MIMX9111xxxxx

config MCUX_HW_IP_DriverType_uSDHC
    bool
    default y
    depends on MCUX_HW_DEVICE_ID_MIMX9111xxxxx

config MCUX_HW_IP_DriverType_SAR_ADC
    bool
    default y
    depends on MCUX_HW_DEVICE_ID_MIMX9111xxxxx
```

## i.MX91/MIMX9131/Kconfig
```kconfig
# Copyright 2025 NXP
#
# SPDX-License-Identifier: BSD-3-Clause

rsource "Kconfig.chip"
rsource "drivers/Kconfig"
rsource "../../../../devices/arm/Kconfig.common"
rsource "Kconfig.defconfig"

config MCUX_HW_DEVICE_MIMX9131_CORE_ID_ca55
    bool
    default y

## pinmux dependency
config MCUX_DEPENDENCY_PINMUX
    bool
    default n

    imply MCUX_COMPONENT_driver.rgpio
    imply MCUX_COMPONENT_driver.port

## Project segment and component dependency data
config MCUX_HW_DEVICE_MIMX9131
    # bool "Device MIMX9131 Configuration"
    bool
    default y
    ## Project segment dependency data

    select MCUX_COMPONENT_driver.port if MCUX_PRJSEG_module.board.pinmux
    select MCUX_COMPONENT_driver.rgpio if MCUX_PRJSEG_module.board.pinmux
    select MCUX_COMPONENT_driver.clock if MCUX_PRJSEG_module.board.clock
    select MCUX_COMPONENT_component.lpuart_adapter if MCUX_PRJSEG_module.board.console_lite
    select MCUX_COMPONENT_driver.lpuart if MCUX_PRJSEG_module.board.console_lite

    # component dependency
    select MCUX_COMPONENT_driver.edma4 if MCUX_COMPONENT_driver.sai_edma
    select MCUX_COMPONENT_driver.edma4 if MCUX_COMPONENT_driver.lpi2c_edma
    select MCUX_COMPONENT_driver.edma4 if MCUX_COMPONENT_driver.lpspi_edma
    select MCUX_COMPONENT_driver.edma4 if MCUX_COMPONENT_driver.lpuart_edma
    select MCUX_COMPONENT_driver.edma4 if MCUX_COMPONENT_driver.flexspi_edma
    select MCUX_COMPONENT_driver.edma4 if MCUX_COMPONENT_driver.pdm_edma
    select MCUX_COMPONENT_driver.edma4 if MCUX_COMPONENT_driver.flexcan_edma
    select MCUX_COMPONENT_component.lpuart_adapter if MCUX_COMPONENT_component.serial_manager_uart
    select MCUX_COMPONENT_component.lpuart_adapter if MCUX_COMPONENT_utility.debug_console_lite
    select MCUX_COMPONENT_driver.edma_soc if MCUX_COMPONENT_driver.edma4
    select MCUX_COMPONENT_driver.memory if MCUX_COMPONENT_driver.edma4
    select MCUX_COMPONENT_driver.memory if MCUX_COMPONENT_driver.enet
    select MCUX_COMPONENT_driver.memory if MCUX_COMPONENT_driver.enet_qos
```

## i.MX91/MIMX9131/Kconfig.chip
```kconfig
# Copyright 2024-2025 NXP
# All rights reserved.
#
# SPDX-License-Identifier: BSD-3-Clause

# product related

config MCUX_HW_SOC_SERIES_MIMX
    bool
    default y

config MCUX_HW_SOC_SINGLECORE_DEVICE
    bool
    default y

# core related

config MCUX_HW_CORE
    string
    default "ca55"

config MCUX_HW_CORE_CA55
    bool
    default y

config MCUX_HW_CORE_ID
    string
    default "ca55"

config MCUX_HW_CORE_ID_CA55
    bool
    default y

config MCUX_HW_DSP
    bool
    default n

config MCUX_HW_MPU
    bool
    default n

config MCUX_HW_SAU
    bool
    default n

config MCUX_HW_INT_PRIO_BITS
    int
    default 4

# device related

config MCUX_HW_DEVICE_CORE
    string
    default "MIMX9131"

config MCUX_HW_DEVICE_ID_MIMX9131xxxxJ
    bool

choice MCUX_HW_DEVICE_PART_MIMX9131
    prompt "Device MIMX9131 Part"
    config MCUX_HW_DEVICE_PART_MIMX9131CVVXJ
    bool "MIMX9131CVVXJ"
    select MCUX_HW_DEVICE_ID_MIMX9131xxxxJ
    config MCUX_HW_DEVICE_PART_MIMX9131DVVXJ
    bool "MIMX9131DVVXJ"
    select MCUX_HW_DEVICE_ID_MIMX9131xxxxJ
endchoice

config MCUX_HW_DEVICE_ID
    string
    default "MIMX9131xxxxJ" if MCUX_HW_DEVICE_ID_MIMX9131xxxxJ

config MCUX_HW_DEVICE_PART
    string
    default "MIMX9131CVVXJ" if MCUX_HW_DEVICE_PART_MIMX9131CVVXJ
    default "MIMX9131DVVXJ" if MCUX_HW_DEVICE_PART_MIMX9131DVVXJ

# ip information

config MCUX_HW_IP_DriverType_AXBS
    bool
    default y
    depends on MCUX_HW_DEVICE_ID_MIMX9131xxxxJ

config MCUX_HW_IP_DriverType_BLK_CTRL_MEDIAMIX
    bool
    default y
    depends on MCUX_HW_DEVICE_ID_MIMX9131xxxxJ

config MCUX_HW_IP_DriverType_BLK_CTRL_NIC_WRAPPER
    bool
    default y
    depends on MCUX_HW_DEVICE_ID_MIMX9131xxxxJ

config MCUX_HW_IP_DriverType_BLK_CTRL_NS_AONMIX
    bool
    default y
    depends on MCUX_HW_DEVICE_ID_MIMX9131xxxxJ

config MCUX_HW_IP_DriverType_BLK_CTRL_S_AONMIX
    bool
    default y
    depends on MCUX_HW_DEVICE_ID_MIMX9131xxxxJ

config MCUX_HW_IP_DriverType_BLK_CTRL_WAKEUPMIX
    bool
    default y
    depends on MCUX_HW_DEVICE_ID_MIMX9131xxxxJ

config MCUX_HW_IP_DriverType_CACHE
    bool
    default y
    depends on MCUX_HW_DEVICE_ID_MIMX9131xxxxJ

config MCUX_HW_IP_DriverType_DDR
    bool
    default y
    depends on MCUX_HW_DEVICE_ID_MIMX9131xxxxJ

config MCUX_HW_IP_DriverType_D_IP_MX91_CCM
    bool
    default y
    depends on MCUX_HW_DEVICE_ID_MIMX9131xxxxJ

config MCUX_HW_IP_DriverType_EDMA3
    bool
    default y
    depends on MCUX_HW_DEVICE_ID_MIMX9131xxxxJ

config MCUX_HW_IP_DriverType_EDMA4
    bool
    default y
    depends on MCUX_HW_DEVICE_ID_MIMX9131xxxxJ

config MCUX_HW_IP_DriverType_ENET
    bool
    default y
    depends on MCUX_HW_DEVICE_ID_MIMX9131xxxxJ

config MCUX_HW_IP_DriverType_ENET_QOS
    bool
    default y
    depends on MCUX_HW_DEVICE_ID_MIMX9131xxxxJ

config MCUX_HW_IP_DriverType_FLEXCAN
    bool
    default y
    depends on MCUX_HW_DEVICE_ID_MIMX9131xxxxJ

config MCUX_HW_IP_DriverType_FLEXIO
    bool
    default y
    depends on MCUX_HW_DEVICE_ID_MIMX9131xxxxJ

config MCUX_HW_IP_DriverType_FLEXSPI
    bool
    default y
    depends on MCUX_HW_DEVICE_ID_MIMX9131xxxxJ

config MCUX_HW_IP_DriverType_FSB
    bool
    default y
    depends on MCUX_HW_DEVICE_ID_MIMX9131xxxxJ

config MCUX_HW_IP_DriverType_I3C
    bool
    default y
    depends on MCUX_HW_DEVICE_ID_MIMX9131xxxxJ

config MCUX_HW_IP_DriverType_ISI
    bool
    default y
    depends on MCUX_HW_DEVICE_ID_MIMX9131xxxxJ

config MCUX_HW_IP_DriverType_JTAGC
    bool
    default y
    depends on MCUX_HW_DEVICE_ID_MIMX9131xxxxJ

config MCUX_HW_IP_DriverType_LCDIF
    bool
    default y
    depends on MCUX_HW_DEVICE_ID_MIMX9131xxxxJ

config MCUX_HW_IP_DriverType_LPI2C
    bool
    default y
    depends on MCUX_HW_DEVICE_ID_MIMX9131xxxxJ

config MCUX_HW_IP_DriverType_LPIT
    bool
    default y
    depends on MCUX_HW_DEVICE_ID_MIMX9131xxxxJ

config MCUX_HW_IP_DriverType_LPSPI
    bool
    default y
    depends on MCUX_HW_DEVICE_ID_MIMX9131xxxxJ

config MCUX_HW_IP_DriverType_LPTMR
    bool
    default y
    depends on MCUX_HW_DEVICE_ID_MIMX9131xxxxJ

config MCUX_HW_IP_DriverType_LPUART
    bool
    default y
    depends on MCUX_HW_DEVICE_ID_MIMX9131xxxxJ

config MCUX_HW_IP_DriverType_MQS
    bool
    default y
    depends on MCUX_HW_DEVICE_ID_MIMX9131xxxxJ

config MCUX_HW_IP_DriverType_PDM
    bool
    default y
    depends on MCUX_HW_DEVICE_ID_MIMX9131xxxxJ

config MCUX_HW_IP_DriverType_RGPIO
    bool
    default y
    depends on MCUX_HW_DEVICE_ID_MIMX9131xxxxJ

config MCUX_HW_IP_DriverType_SAI
    bool
    default y
    depends on MCUX_HW_DEVICE_ID_MIMX9131xxxxJ

config MCUX_HW_IP_DriverType_SAR_ADC
    bool
    default y
    depends on MCUX_HW_DEVICE_ID_MIMX9131xxxxJ

config MCUX_HW_IP_DriverType_SEMA42
    bool
    default y
    depends on MCUX_HW_DEVICE_ID_MIMX9131xxxxJ

config MCUX_HW_IP_DriverType_SPDIF
    bool
    default y
    depends on MCUX_HW_DEVICE_ID_MIMX9131xxxxJ

config MCUX_HW_IP_DriverType_SYS_CTR_COMPARE
    bool
    default y
    depends on MCUX_HW_DEVICE_ID_MIMX9131xxxxJ

config MCUX_HW_IP_DriverType_SYS_CTR_CONTROL
    bool
    default y
    depends on MCUX_HW_DEVICE_ID_MIMX9131xxxxJ

config MCUX_HW_IP_DriverType_SYS_CTR_READ
    bool
    default y
    depends on MCUX_HW_DEVICE_ID_MIMX9131xxxxJ

config MCUX_HW_IP_DriverType_TPM
    bool
    default y
    depends on MCUX_HW_DEVICE_ID_MIMX9131xxxxJ

config MCUX_HW_IP_DriverType_TRDC_1
    bool
    default y
    depends on MCUX_HW_DEVICE_ID_MIMX9131xxxxJ

config MCUX_HW_IP_DriverType_TRGMUX
    bool
    default y
    depends on MCUX_HW_DEVICE_ID_MIMX9131xxxxJ

config MCUX_HW_IP_DriverType_TSTMR
    bool
    default y
    depends on MCUX_HW_DEVICE_ID_MIMX9131xxxxJ

config MCUX_HW_IP_DriverType_USDHC
    bool
    default y
    depends on MCUX_HW_DEVICE_ID_MIMX9131xxxxJ

config MCUX_HW_IP_DriverType_WDOG32
    bool
    default y
    depends on MCUX_HW_DEVICE_ID_MIMX9131xxxxJ

config MCUX_HW_IP_DriverType_blk_ctrl_ddrmix
    bool
    default y
    depends on MCUX_HW_DEVICE_ID_MIMX9131xxxxJ

config MCUX_TOOLCHAIN_LINKER_DEVICE_PREFIX
    string
    default "MIMX9131xxxxJ" if MCUX_HW_DEVICE_ID_MIMX9131xxxxJ
```

## i.MX91/MIMX9131/ca55/Kconfig.chip
```kconfig
# Copyright 2025 NXP
#
# SPDX-License-Identifier: BSD-3-Clause

# core related
config MCUX_HW_CORE
    string
    default "ca55"

config MCUX_HW_CORE_CA55
    bool
    default y

config MCUX_HW_CORE_ID
    string
    default "ca55"

config MCUX_HW_CORE_ID_CA55
    bool
    default y

config MCUX_HW_DEVICE_CORE
    string
    default "MIMX9131"

config MCUX_HW_SOC_SERIES_MIMX
    bool
    default y

# For chipmodel generated files
config MCUX_TOOLCHAIN_LINKER_DEVICE_PREFIX
    string
    default "MIMX9131xxxxx" if MCUX_HW_DEVICE_ID_MIMX9131xxxxx
```
