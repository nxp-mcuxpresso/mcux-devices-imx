## i.MX8M/MIMX8MQ6/drivers/Kconfig
```kconfig
# Copyright 2024 NXP
# All rights reserved.
#
# SPDX-License-Identifier: BSD-3-Clause

menu "Device specific drivers configuration"

    config MCUX_COMPONENT_driver.clock
         bool "clock"
         default y

    config MCUX_COMPONENT_driver.iomuxc
         bool "iomuxc"
         default y

    config MCUX_COMPONENT_driver.memory
         bool "memory"
         default y

endmenu
```

## i.MX8MM/MIMX8MM6/ca53/Kconfig
```kconfig
# Copyright 2025 NXP
#
# SPDX-License-Identifier: BSD-3-Clause

config MCUX_HW_DEVICE_MIMX8MM6_CORE_ID_ca53
    bool
    default y

rsource "Kconfig.chip"
```

## i.MX8MM/MIMX8MM6/cm4/Kconfig.chip
```kconfig
# Copyright 2025 NXP
#
# SPDX-License-Identifier: BSD-3-Clause

# core related
config MCUX_HW_CORE
    string
    default "cm4f"

config MCUX_HW_CORE_CM4F
    bool
    default y

config MCUX_HW_CORE_ID
    string
    default "cm4"

config MCUX_HW_CORE_ID_CM4
    bool
    default y

config MCUX_HW_DEVICE_CORE
    string
    default "MIMX8MM6_cm4"

config MCUX_HW_FPU
    string
    default "SP_FPU"

config MCUX_HW_FPU_TYPE
    string
    default "fpv4_sp"

config MCUX_HW_FPV4_SP
    bool
    default y

config MCUX_HW_INT_PRIO_BITS
    int
    default 4

config MCUX_HW_SOC_SERIES_MIMX
    bool
    default y

config MCUX_HW_SOC_SINGLECORE_DEVICE
    bool
    default y

# For chipmodel generated files
config MCUX_TOOLCHAIN_LINKER_DEVICE_PREFIX
    string
    default "MIMX8MM6xxxLZ" if MCUX_HW_DEVICE_ID_MIMX8MM6xxxLZ
    default "MIMX8MM6xxxKZ" if MCUX_HW_DEVICE_ID_MIMX8MM6xxxKZ

config MCUX_TOOLCHAIN_MCUX_STARTUP
    string
    default "mimx8mm6"

# Toolchain related

config MCUX_TOOLCHAIN_IAR_CPU_IDENTIFIER
    string
    default "MIMX8MM6_M4" if MCUX_HW_DEVICE_ID_MIMX8MM6xxxLZ
    default "MIMX8MM6_M4" if MCUX_HW_DEVICE_ID_MIMX8MM6xxxKZ

config MCUX_TOOLCHAIN_MDK_CPU_IDENTIFIER
    string
    default "MIMX8MM6DVTLZ" if MCUX_HW_DEVICE_PART_MIMX8MM6DVTLZ
    default "MIMX8MM6CVTKZ" if MCUX_HW_DEVICE_PART_MIMX8MM6CVTKZ
```

## i.MX8MN/MIMX8MN1/Kconfig.chip
```kconfig
# Copyright 2024-2025 NXP
# All rights reserved.
#
# SPDX-License-Identifier: BSD-3-Clause

# product related

config MCUX_HW_SOC_SERIES_MIMX
    bool
    default y

config MCUX_HW_SOC_MULTICORE_DEVICE
    bool
    default y

# device related

config MCUX_HW_DEVICE_ID_MIMX8MN1xxxIZ
    bool

config MCUX_HW_DEVICE_ID_MIMX8MN1xxxJZ
    bool

choice MCUX_HW_DEVICE_PART_MIMX8MN1
    prompt "Device MIMX8MN1 Part"
    config MCUX_HW_DEVICE_PART_MIMX8MN1CVTIZ
    bool "MIMX8MN1CVTIZ"
    select MCUX_HW_DEVICE_ID_MIMX8MN1xxxIZ
    config MCUX_HW_DEVICE_PART_MIMX8MN1CVPIZ
    bool "MIMX8MN1CVPIZ"
    select MCUX_HW_DEVICE_ID_MIMX8MN1xxxIZ
    config MCUX_HW_DEVICE_PART_MIMX8MN1DVPIZ
    bool "MIMX8MN1DVPIZ"
    select MCUX_HW_DEVICE_ID_MIMX8MN1xxxIZ
    config MCUX_HW_DEVICE_PART_MIMX8MN1DVTJZ
    bool "MIMX8MN1DVTJZ"
    select MCUX_HW_DEVICE_ID_MIMX8MN1xxxJZ
endchoice

config MCUX_HW_DEVICE_ID
    string
    default "MIMX8MN1xxxIZ" if MCUX_HW_DEVICE_ID_MIMX8MN1xxxIZ
    default "MIMX8MN1xxxJZ" if MCUX_HW_DEVICE_ID_MIMX8MN1xxxJZ

config MCUX_HW_DEVICE_PART
    string
    default "MIMX8MN1CVTIZ" if MCUX_HW_DEVICE_PART_MIMX8MN1CVTIZ
    default "MIMX8MN1CVPIZ" if MCUX_HW_DEVICE_PART_MIMX8MN1CVPIZ
    default "MIMX8MN1DVPIZ" if MCUX_HW_DEVICE_PART_MIMX8MN1DVPIZ
    default "MIMX8MN1DVTJZ" if MCUX_HW_DEVICE_PART_MIMX8MN1DVTJZ

# ip information

config MCUX_HW_IP_DriverType_AIPSTZ
    bool
    default y
    depends on MCUX_HW_DEVICE_ID_MIMX8MN1xxxIZ || MCUX_HW_DEVICE_ID_MIMX8MN1xxxJZ

config MCUX_HW_IP_DriverType_APBH
    bool
    default y
    depends on MCUX_HW_DEVICE_ID_MIMX8MN1xxxIZ || MCUX_HW_DEVICE_ID_MIMX8MN1xxxJZ

config MCUX_HW_IP_DriverType_BCH
    bool
    default y
    depends on MCUX_HW_DEVICE_ID_MIMX8MN1xxxIZ || MCUX_HW_DEVICE_ID_MIMX8MN1xxxJZ

config MCUX_HW_IP_DriverType_CCM
    bool
    default y
    depends on MCUX_HW_DEVICE_ID_MIMX8MN1xxxIZ || MCUX_HW_DEVICE_ID_MIMX8MN1xxxJZ

config MCUX_HW_IP_DriverType_CCM_ANALOG
    bool
    default y
    depends on MCUX_HW_DEVICE_ID_MIMX8MN1xxxIZ || MCUX_HW_DEVICE_ID_MIMX8MN1xxxJZ

config MCUX_HW_IP_DriverType_DDRC_REGS
    bool
    default y
    depends on MCUX_HW_DEVICE_ID_MIMX8MN1xxxIZ || MCUX_HW_DEVICE_ID_MIMX8MN1xxxJZ

config MCUX_HW_IP_DriverType_DPH_DEF_DOMAIN
    bool
    default y
    depends on MCUX_HW_DEVICE_ID_MIMX8MN1xxxIZ || MCUX_HW_DEVICE_ID_MIMX8MN1xxxJZ

config MCUX_HW_IP_DriverType_DWC_DDRPHYA_ANIB
    bool
    default y
    depends on MCUX_HW_DEVICE_ID_MIMX8MN1xxxIZ || MCUX_HW_DEVICE_ID_MIMX8MN1xxxJZ

config MCUX_HW_IP_DriverType_DWC_DDRPHYA_APBONLY
    bool
    default y
    depends on MCUX_HW_DEVICE_ID_MIMX8MN1xxxIZ || MCUX_HW_DEVICE_ID_MIMX8MN1xxxJZ

config MCUX_HW_IP_DriverType_DWC_DDRPHYA_DBYTE
    bool
    default y
    depends on MCUX_HW_DEVICE_ID_MIMX8MN1xxxIZ || MCUX_HW_DEVICE_ID_MIMX8MN1xxxJZ

config MCUX_HW_IP_DriverType_DWC_DDRPHYA_DRTUB
    bool
    default y
    depends on MCUX_HW_DEVICE_ID_MIMX8MN1xxxIZ || MCUX_HW_DEVICE_ID_MIMX8MN1xxxJZ

config MCUX_HW_IP_DriverType_DWC_DDRPHYA_INITENG
    bool
    default y
    depends on MCUX_HW_DEVICE_ID_MIMX8MN1xxxIZ || MCUX_HW_DEVICE_ID_MIMX8MN1xxxJZ

config MCUX_HW_IP_DriverType_DWC_DDRPHYA_MASTER
    bool
    default y
    depends on MCUX_HW_DEVICE_ID_MIMX8MN1xxxIZ || MCUX_HW_DEVICE_ID_MIMX8MN1xxxJZ

config MCUX_HW_IP_DriverType_EASRC
    bool
    default y
    depends on MCUX_HW_DEVICE_ID_MIMX8MN1xxxIZ || MCUX_HW_DEVICE_ID_MIMX8MN1xxxJZ

config MCUX_HW_IP_DriverType_ECSPI
    bool
    default y
    depends on MCUX_HW_DEVICE_ID_MIMX8MN1xxxIZ || MCUX_HW_DEVICE_ID_MIMX8MN1xxxJZ

config MCUX_HW_IP_DriverType_ENET
    bool
    default y
    depends on MCUX_HW_DEVICE_ID_MIMX8MN1xxxIZ || MCUX_HW_DEVICE_ID_MIMX8MN1xxxJZ

config MCUX_HW_IP_DriverType_FLEXSPI
    bool
    default y
    depends on MCUX_HW_DEVICE_ID_MIMX8MN1xxxIZ || MCUX_HW_DEVICE_ID_MIMX8MN1xxxJZ

config MCUX_HW_IP_DriverType_GPC_2
    bool
    default y
    depends on MCUX_HW_DEVICE_ID_MIMX8MN1xxxIZ || MCUX_HW_DEVICE_ID_MIMX8MN1xxxJZ

config MCUX_HW_IP_DriverType_GPC_PGC
    bool
    default y
    depends on MCUX_HW_DEVICE_ID_MIMX8MN1xxxIZ || MCUX_HW_DEVICE_ID_MIMX8MN1xxxJZ

config MCUX_HW_IP_DriverType_GPMI
    bool
    default y
    depends on MCUX_HW_DEVICE_ID_MIMX8MN1xxxIZ || MCUX_HW_DEVICE_ID_MIMX8MN1xxxJZ

config MCUX_HW_IP_DriverType_GPT
    bool
    default y
    depends on MCUX_HW_DEVICE_ID_MIMX8MN1xxxIZ || MCUX_HW_DEVICE_ID_MIMX8MN1xxxJZ

config MCUX_HW_IP_DriverType_IGPIO
    bool
    default y
    depends on MCUX_HW_DEVICE_ID_MIMX8MN1xxxIZ || MCUX_HW_DEVICE_ID_MIMX8MN1xxxJZ

config MCUX_HW_IP_DriverType_II2C
    bool
    default y
    depends on MCUX_HW_DEVICE_ID_MIMX8MN1xxxIZ || MCUX_HW_DEVICE_ID_MIMX8MN1xxxJZ

config MCUX_HW_IP_DriverType_IOMUXC
    bool
    default y
    depends on MCUX_HW_DEVICE_ID_MIMX8MN1xxxIZ || MCUX_HW_DEVICE_ID_MIMX8MN1xxxJZ

config MCUX_HW_IP_DriverType_IOMUXC_GPR
    bool
    default y
    depends on MCUX_HW_DEVICE_ID_MIMX8MN1xxxIZ || MCUX_HW_DEVICE_ID_MIMX8MN1xxxJZ

config MCUX_HW_IP_DriverType_IPWM
    bool
    default y
    depends on MCUX_HW_DEVICE_ID_MIMX8MN1xxxIZ || MCUX_HW_DEVICE_ID_MIMX8MN1xxxJZ

config MCUX_HW_IP_DriverType_ISI
    bool
    default y
    depends on MCUX_HW_DEVICE_ID_MIMX8MN1xxxIZ || MCUX_HW_DEVICE_ID_MIMX8MN1xxxJZ

config MCUX_HW_IP_DriverType_IUART
    bool
    default y
    depends on MCUX_HW_DEVICE_ID_MIMX8MN1xxxIZ || MCUX_HW_DEVICE_ID_MIMX8MN1xxxJZ

config MCUX_HW_IP_DriverType_LCDIF
    bool
    default y
    depends on MCUX_HW_DEVICE_ID_MIMX8MN1xxxIZ || MCUX_HW_DEVICE_ID_MIMX8MN1xxxJZ

config MCUX_HW_IP_DriverType_MIPI_CSI
    bool
    default y
    depends on MCUX_HW_DEVICE_ID_MIMX8MN1xxxIZ || MCUX_HW_DEVICE_ID_MIMX8MN1xxxJZ

config MCUX_HW_IP_DriverType_MU
    bool
    default y
    depends on MCUX_HW_DEVICE_ID_MIMX8MN1xxxIZ || MCUX_HW_DEVICE_ID_MIMX8MN1xxxJZ

config MCUX_HW_IP_DriverType_OCOTP
    bool
    default y
    depends on MCUX_HW_DEVICE_ID_MIMX8MN1xxxIZ || MCUX_HW_DEVICE_ID_MIMX8MN1xxxJZ

config MCUX_HW_IP_DriverType_PDM
    bool
    default y
    depends on MCUX_HW_DEVICE_ID_MIMX8MN1xxxIZ || MCUX_HW_DEVICE_ID_MIMX8MN1xxxJZ

config MCUX_HW_IP_DriverType_RDC
    bool
    default y
    depends on MCUX_HW_DEVICE_ID_MIMX8MN1xxxIZ || MCUX_HW_DEVICE_ID_MIMX8MN1xxxJZ

config MCUX_HW_IP_DriverType_RDC_SEMAPHORE
    bool
    default y
    depends on MCUX_HW_DEVICE_ID_MIMX8MN1xxxIZ || MCUX_HW_DEVICE_ID_MIMX8MN1xxxJZ

config MCUX_HW_IP_DriverType_SAI
    bool
    default y
    depends on MCUX_HW_DEVICE_ID_MIMX8MN1xxxIZ || MCUX_HW_DEVICE_ID_MIMX8MN1xxxJZ

config MCUX_HW_IP_DriverType_SDMAARM
    bool
    default y
    depends on MCUX_HW_DEVICE_ID_MIMX8MN1xxxIZ || MCUX_HW_DEVICE_ID_MIMX8MN1xxxJZ

config MCUX_HW_IP_DriverType_SEMA4
    bool
    default y
    depends on MCUX_HW_DEVICE_ID_MIMX8MN1xxxIZ || MCUX_HW_DEVICE_ID_MIMX8MN1xxxJZ

config MCUX_HW_IP_DriverType_SNVS
    bool
    default y
    depends on MCUX_HW_DEVICE_ID_MIMX8MN1xxxIZ || MCUX_HW_DEVICE_ID_MIMX8MN1xxxJZ

config MCUX_HW_IP_DriverType_SPBA
    bool
    default y
    depends on MCUX_HW_DEVICE_ID_MIMX8MN1xxxIZ || MCUX_HW_DEVICE_ID_MIMX8MN1xxxJZ

config MCUX_HW_IP_DriverType_SPDIF
    bool
    default y
    depends on MCUX_HW_DEVICE_ID_MIMX8MN1xxxIZ || MCUX_HW_DEVICE_ID_MIMX8MN1xxxJZ

config MCUX_HW_IP_DriverType_SRC
    bool
    default y
    depends on MCUX_HW_DEVICE_ID_MIMX8MN1xxxIZ || MCUX_HW_DEVICE_ID_MIMX8MN1xxxJZ

config MCUX_HW_IP_DriverType_TMU_1
    bool
    default y
    depends on MCUX_HW_DEVICE_ID_MIMX8MN1xxxIZ || MCUX_HW_DEVICE_ID_MIMX8MN1xxxJZ

config MCUX_HW_IP_DriverType_USB
    bool
    default y
    depends on MCUX_HW_DEVICE_ID_MIMX8MN1xxxIZ || MCUX_HW_DEVICE_ID_MIMX8MN1xxxJZ

config MCUX_HW_IP_DriverType_USBNC
    bool
    default y
    depends on MCUX_HW_DEVICE_ID_MIMX8MN1xxxIZ || MCUX_HW_DEVICE_ID_MIMX8MN1xxxJZ

config MCUX_HW_IP_DriverType_USDHC
    bool
    default y
    depends on MCUX_HW_DEVICE_ID_MIMX8MN1xxxIZ || MCUX_HW_DEVICE_ID_MIMX8MN1xxxJZ

config MCUX_HW_IP_DriverType_WDOG01
    bool
    default y
    depends on MCUX_HW_DEVICE_ID_MIMX8MN1xxxIZ || MCUX_HW_DEVICE_ID_MIMX8MN1xxxJZ

config MCUX_HW_IP_DriverType_XTALOSC
    bool
    default y
    depends on MCUX_HW_DEVICE_ID_MIMX8MN1xxxIZ || MCUX_HW_DEVICE_ID_MIMX8MN1xxxJZ
```

## i.MX8MN/MIMX8MN3/cm7/Kconfig.chip
```kconfig
# Copyright 2024-2025 NXP
# All rights reserved.
#
# SPDX-License-Identifier: BSD-3-Clause

# core related

config MCUX_HW_CORE
    string
    default "cm7f"

config MCUX_HW_CORE_CM7F
    bool
    default y

config MCUX_HW_CORE_ID
    string
    default "cm7"

config MCUX_HW_CORE_ID_CM7
    bool
    default y

config MCUX_HW_DSP
    bool
    default n

config MCUX_HW_MPU
    bool
    default y

config MCUX_HW_FPU
    string
    default "SP_FPU"

config MCUX_HW_FPU_TYPE
    string
    default "fpv5_dp"

config MCUX_HW_FPV5_DP
    bool
    default y

config MCUX_HW_SAU
    bool
    default n

config MCUX_HW_INT_PRIO_BITS
    int
    default 4

# device related

config MCUX_HW_DEVICE_CORE
    string
    default "MIMX8MN3_cm7"

# core-specific ip information

config MCUX_HW_IP_DriverType_MEMORY
    bool
    default y
    depends on MCUX_HW_DEVICE_ID_MIMX8MN3xxxJZ
```
