## i.MX8MN/MIMX8MN5/Kconfig.chip
```kconfig
# Copyright 2024-2025 NXP
# All rights reserved.
#
# SPDX-License-Identifier: BSD-3-Clause

# product related

config MCUX_HW_SOC_SERIES_MIMX
    bool
    default y

config MCUX_HW_SOC_MULTICORE_DEVICE
    bool
    default y

# device related

config MCUX_HW_DEVICE_ID_MIMX8MN5xxxIZ
    bool

config MCUX_HW_DEVICE_ID_MIMX8MN5xxxJZ
    bool

choice MCUX_HW_DEVICE_PART_MIMX8MN5
    prompt "Device MIMX8MN5 Part"
    config MCUX_HW_DEVICE_PART_MIMX8MN5CVTIZ
    bool "MIMX8MN5CVTIZ"
    select MCUX_HW_DEVICE_ID_MIMX8MN5xxxIZ
    config MCUX_HW_DEVICE_PART_MIMX8MN5CVPIZ
    bool "MIMX8MN5CVPIZ"
    select MCUX_HW_DEVICE_ID_MIMX8MN5xxxIZ
    config MCUX_HW_DEVICE_PART_MIMX8MN5DVPIZ
    bool "MIMX8MN5DVPIZ"
    select MCUX_HW_DEVICE_ID_MIMX8MN5xxxIZ
    config MCUX_HW_DEVICE_PART_MIMX8MN5DVTJZ
    bool "MIMX8MN5DVTJZ"
    select MCUX_HW_DEVICE_ID_MIMX8MN5xxxJZ
endchoice

config MCUX_HW_DEVICE_ID
    string
    default "MIMX8MN5xxxIZ" if MCUX_HW_DEVICE_ID_MIMX8MN5xxxIZ
    default "MIMX8MN5xxxJZ" if MCUX_HW_DEVICE_ID_MIMX8MN5xxxJZ

config MCUX_HW_DEVICE_PART
    string
    default "MIMX8MN5CVTIZ" if MCUX_HW_DEVICE_PART_MIMX8MN5CVTIZ
    default "MIMX8MN5CVPIZ" if MCUX_HW_DEVICE_PART_MIMX8MN5CVPIZ
    default "MIMX8MN5DVPIZ" if MCUX_HW_DEVICE_PART_MIMX8MN5DVPIZ
    default "MIMX8MN5DVTJZ" if MCUX_HW_DEVICE_PART_MIMX8MN5DVTJZ

# ip information

config MCUX_HW_IP_DriverType_AIPSTZ
    bool
    default y
    depends on MCUX_HW_DEVICE_ID_MIMX8MN5xxxIZ || MCUX_HW_DEVICE_ID_MIMX8MN5xxxJZ

config MCUX_HW_IP_DriverType_APBH
    bool
    default y
    depends on MCUX_HW_DEVICE_ID_MIMX8MN5xxxIZ || MCUX_HW_DEVICE_ID_MIMX8MN5xxxJZ

config MCUX_HW_IP_DriverType_BCH
    bool
    default y
    depends on MCUX_HW_DEVICE_ID_MIMX8MN5xxxIZ || MCUX_HW_DEVICE_ID_MIMX8MN5xxxJZ

config MCUX_HW_IP_DriverType_CCM
    bool
    default y
    depends on MCUX_HW_DEVICE_ID_MIMX8MN5xxxIZ || MCUX_HW_DEVICE_ID_MIMX8MN5xxxJZ

config MCUX_HW_IP_DriverType_CCM_ANALOG
    bool
    default y
    depends on MCUX_HW_DEVICE_ID_MIMX8MN5xxxIZ || MCUX_HW_DEVICE_ID_MIMX8MN5xxxJZ

config MCUX_HW_IP_DriverType_DDRC_REGS
    bool
    default y
    depends on MCUX_HW_DEVICE_ID_MIMX8MN5xxxIZ || MCUX_HW_DEVICE_ID_MIMX8MN5xxxJZ

config MCUX_HW_IP_DriverType_DPH_DEF_DOMAIN
    bool
    default y
    depends on MCUX_HW_DEVICE_ID_MIMX8MN5xxxIZ || MCUX_HW_DEVICE_ID_MIMX8MN5xxxJZ

config MCUX_HW_IP_DriverType_DWC_DDRPHYA_ANIB
    bool
    default y
    depends on MCUX_HW_DEVICE_ID_MIMX8MN5xxxIZ || MCUX_HW_DEVICE_ID_MIMX8MN5xxxJZ

config MCUX_HW_IP_DriverType_DWC_DDRPHYA_APBONLY
    bool
    default y
    depends on MCUX_HW_DEVICE_ID_MIMX8MN5xxxIZ || MCUX_HW_DEVICE_ID_MIMX8MN5xxxJZ

config MCUX_HW_IP_DriverType_DWC_DDRPHYA_DBYTE
    bool
    default y
    depends on MCUX_HW_DEVICE_ID_MIMX8MN5xxxIZ || MCUX_HW_DEVICE_ID_MIMX8MN5xxxJZ

config MCUX_HW_IP_DriverType_DWC_DDRPHYA_DRTUB
    bool
    default y
    depends on MCUX_HW_DEVICE_ID_MIMX8MN5xxxIZ || MCUX_HW_DEVICE_ID_MIMX8MN5xxxJZ

config MCUX_HW_IP_DriverType_DWC_DDRPHYA_INITENG
    bool
    default y
    depends on MCUX_HW_DEVICE_ID_MIMX8MN5xxxIZ || MCUX_HW_DEVICE_ID_MIMX8MN5xxxJZ

config MCUX_HW_IP_DriverType_DWC_DDRPHYA_MASTER
    bool
    default y
    depends on MCUX_HW_DEVICE_ID_MIMX8MN5xxxIZ || MCUX_HW_DEVICE_ID_MIMX8MN5xxxJZ

config MCUX_HW_IP_DriverType_EASRC
    bool
    default y
    depends on MCUX_HW_DEVICE_ID_MIMX8MN5xxxIZ || MCUX_HW_DEVICE_ID_MIMX8MN5xxxJZ

config MCUX_HW_IP_DriverType_ECSPI
    bool
    default y
    depends on MCUX_HW_DEVICE_ID_MIMX8MN5xxxIZ || MCUX_HW_DEVICE_ID_MIMX8MN5xxxJZ

config MCUX_HW_IP_DriverType_ENET
    bool
    default y
    depends on MCUX_HW_DEVICE_ID_MIMX8MN5xxxIZ || MCUX_HW_DEVICE_ID_MIMX8MN5xxxJZ

config MCUX_HW_IP_DriverType_FLEXSPI
    bool
    default y
    depends on MCUX_HW_DEVICE_ID_MIMX8MN5xxxIZ || MCUX_HW_DEVICE_ID_MIMX8MN5xxxJZ

config MCUX_HW_IP_DriverType_GPC_2
    bool
    default y
    depends on MCUX_HW_DEVICE_ID_MIMX8MN5xxxIZ || MCUX_HW_DEVICE_ID_MIMX8MN5xxxJZ

config MCUX_HW_IP_DriverType_GPC_PGC
    bool
    default y
    depends on MCUX_HW_DEVICE_ID_MIMX8MN5xxxIZ || MCUX_HW_DEVICE_ID_MIMX8MN5xxxJZ

config MCUX_HW_IP_DriverType_GPMI
    bool
    default y
    depends on MCUX_HW_DEVICE_ID_MIMX8MN5xxxIZ || MCUX_HW_DEVICE_ID_MIMX8MN5xxxJZ

config MCUX_HW_IP_DriverType_GPT
    bool
    default y
    depends on MCUX_HW_DEVICE_ID_MIMX8MN5xxxIZ || MCUX_HW_DEVICE_ID_MIMX8MN5xxxJZ

config MCUX_HW_IP_DriverType_IGPIO
    bool
    default y
    depends on MCUX_HW_DEVICE_ID_MIMX8MN5xxxIZ || MCUX_HW_DEVICE_ID_MIMX8MN5xxxJZ

config MCUX_HW_IP_DriverType_II2C
    bool
    default y
    depends on MCUX_HW_DEVICE_ID_MIMX8MN5xxxIZ || MCUX_HW_DEVICE_ID_MIMX8MN5xxxJZ

config MCUX_HW_IP_DriverType_IOMUXC
    bool
    default y
    depends on MCUX_HW_DEVICE_ID_MIMX8MN5xxxIZ || MCUX_HW_DEVICE_ID_MIMX8MN5xxxJZ

config MCUX_HW_IP_DriverType_IOMUXC_GPR
    bool
    default y
    depends on MCUX_HW_DEVICE_ID_MIMX8MN5xxxIZ || MCUX_HW_DEVICE_ID_MIMX8MN5xxxJZ

config MCUX_HW_IP_DriverType_IPWM
    bool
    default y
    depends on MCUX_HW_DEVICE_ID_MIMX8MN5xxxIZ || MCUX_HW_DEVICE_ID_MIMX8MN5xxxJZ

config MCUX_HW_IP_DriverType_ISI
    bool
    default y
    depends on MCUX_HW_DEVICE_ID_MIMX8MN5xxxIZ || MCUX_HW_DEVICE_ID_MIMX8MN5xxxJZ

config MCUX_HW_IP_DriverType_IUART
    bool
    default y
    depends on MCUX_HW_DEVICE_ID_MIMX8MN5xxxIZ || MCUX_HW_DEVICE_ID_MIMX8MN5xxxJZ

config MCUX_HW_IP_DriverType_LCDIF
    bool
    default y
    depends on MCUX_HW_DEVICE_ID_MIMX8MN5xxxIZ || MCUX_HW_DEVICE_ID_MIMX8MN5xxxJZ

config MCUX_HW_IP_DriverType_MIPI_CSI
    bool
    default y
    depends on MCUX_HW_DEVICE_ID_MIMX8MN5xxxIZ || MCUX_HW_DEVICE_ID_MIMX8MN5xxxJZ

config MCUX_HW_IP_DriverType_MU
    bool
    default y
    depends on MCUX_HW_DEVICE_ID_MIMX8MN5xxxIZ || MCUX_HW_DEVICE_ID_MIMX8MN5xxxJZ

config MCUX_HW_IP_DriverType_OCOTP
    bool
    default y
    depends on MCUX_HW_DEVICE_ID_MIMX8MN5xxxIZ || MCUX_HW_DEVICE_ID_MIMX8MN5xxxJZ

config MCUX_HW_IP_DriverType_PDM
    bool
    default y
    depends on MCUX_HW_DEVICE_ID_MIMX8MN5xxxIZ || MCUX_HW_DEVICE_ID_MIMX8MN5xxxJZ

config MCUX_HW_IP_DriverType_RDC
    bool
    default y
    depends on MCUX_HW_DEVICE_ID_MIMX8MN5xxxIZ || MCUX_HW_DEVICE_ID_MIMX8MN5xxxJZ

config MCUX_HW_IP_DriverType_RDC_SEMAPHORE
    bool
    default y
    depends on MCUX_HW_DEVICE_ID_MIMX8MN5xxxIZ || MCUX_HW_DEVICE_ID_MIMX8MN5xxxJZ

config MCUX_HW_IP_DriverType_SAI
    bool
    default y
    depends on MCUX_HW_DEVICE_ID_MIMX8MN5xxxIZ || MCUX_HW_DEVICE_ID_MIMX8MN5xxxJZ

config MCUX_HW_IP_DriverType_SDMAARM
    bool
    default y
    depends on MCUX_HW_DEVICE_ID_MIMX8MN5xxxIZ || MCUX_HW_DEVICE_ID_MIMX8MN5xxxJZ

config MCUX_HW_IP_DriverType_SEMA4
    bool
    default y
    depends on MCUX_HW_DEVICE_ID_MIMX8MN5xxxIZ || MCUX_HW_DEVICE_ID_MIMX8MN5xxxJZ

config MCUX_HW_IP_DriverType_SNVS
    bool
    default y
    depends on MCUX_HW_DEVICE_ID_MIMX8MN5xxxIZ || MCUX_HW_DEVICE_ID_MIMX8MN5xxxJZ

config MCUX_HW_IP_DriverType_SPBA
    bool
    default y
    depends on MCUX_HW_DEVICE_ID_MIMX8MN5xxxIZ || MCUX_HW_DEVICE_ID_MIMX8MN5xxxJZ

config MCUX_HW_IP_DriverType_SPDIF
    bool
    default y
    depends on MCUX_HW_DEVICE_ID_MIMX8MN5xxxIZ || MCUX_HW_DEVICE_ID_MIMX8MN5xxxJZ

config MCUX_HW_IP_DriverType_SRC
    bool
    default y
    depends on MCUX_HW_DEVICE_ID_MIMX8MN5xxxIZ || MCUX_HW_DEVICE_ID_MIMX8MN5xxxJZ

config MCUX_HW_IP_DriverType_TMU_1
    bool
    default y
    depends on MCUX_HW_DEVICE_ID_MIMX8MN5xxxIZ || MCUX_HW_DEVICE_ID_MIMX8MN5xxxJZ

config MCUX_HW_IP_DriverType_USB
    bool
    default y
    depends on MCUX_HW_DEVICE_ID_MIMX8MN5xxxIZ || MCUX_HW_DEVICE_ID_MIMX8MN5xxxJZ

config MCUX_HW_IP_DriverType_USBNC
    bool
    default y
    depends on MCUX_HW_DEVICE_ID_MIMX8MN5xxxIZ || MCUX_HW_DEVICE_ID_MIMX8MN5xxxJZ

config MCUX_HW_IP_DriverType_USDHC
    bool
    default y
    depends on MCUX_HW_DEVICE_ID_MIMX8MN5xxxIZ || MCUX_HW_DEVICE_ID_MIMX8MN5xxxJZ

config MCUX_HW_IP_DriverType_WDOG01
    bool
    default y
    depends on MCUX_HW_DEVICE_ID_MIMX8MN5xxxIZ || MCUX_HW_DEVICE_ID_MIMX8MN5xxxJZ

config MCUX_HW_IP_DriverType_XTALOSC
    bool
    default y
    depends on MCUX_HW_DEVICE_ID_MIMX8MN5xxxIZ || MCUX_HW_DEVICE_ID_MIMX8MN5xxxJZ
```

## i.MX8MN/MIMX8MN5/ca53/Kconfig.chip
```kconfig
# Copyright 2024-2025 NXP
# All rights reserved.
#
# SPDX-License-Identifier: BSD-3-Clause

# core related

config MCUX_HW_CORE
    string
    default "ca53"

config MCUX_HW_CORE_CA53
    bool
    default y

config MCUX_HW_CORE_ID
    string
    default "ca53"

config MCUX_HW_CORE_ID_CA53
    bool
    default y

config MCUX_HW_DSP
    bool
    default n

config MCUX_HW_MPU
    bool
    default n

config MCUX_HW_FPU
    string
    default "SP_FPU"

config MCUX_HW_FPU_TYPE
    string
    default "fpv4_sp"

config MCUX_HW_FPV4_SP
    bool
    default y

config MCUX_HW_SAU
    bool
    default n

config MCUX_HW_INT_PRIO_BITS
    int
    default 5

# device related

config MCUX_HW_DEVICE_CORE
    string
    default "MIMX8MN5_ca53"

# core-specific ip information

config MCUX_HW_IP_DriverType_CACHE
    bool
    default y
    depends on MCUX_HW_DEVICE_ID_MIMX8MN5xxxJZ
```
