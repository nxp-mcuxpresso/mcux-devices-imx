## i.MX93/MIMX9352/Kconfig.chip
```kconfig
# Copyright 2024-2025 NXP
#
# SPDX-License-Identifier: BSD-3-Clause

# device related

config MCUX_HW_DEVICE_ID_MIMX9352xxxxM
    bool

choice MCUX_HW_DEVICE_PART_MIMX9352
    prompt "Device MIMX9352 Part"
    config MCUX_HW_DEVICE_PART_MIMX9352DVVXM
    bool "MIMX9352DVVXM"
    select MCUX_HW_DEVICE_ID_MIMX9352xxxxM
    config MCUX_HW_DEVICE_PART_MIMX9352AVTXM
    bool "MIMX9352AVTXM"
    select MCUX_HW_DEVICE_ID_MIMX9352xxxxM
    config MCUX_HW_DEVICE_PART_MIMX9352CVVXM
    bool "MIMX9352CVVXM"
    select MCUX_HW_DEVICE_ID_MIMX9352xxxxM
    config MCUX_HW_DEVICE_PART_MIMX9352XVVXM
    bool "MIMX9352XVVXM"
    select MCUX_HW_DEVICE_ID_MIMX9352xxxxM
endchoice

config MCUX_HW_DEVICE_ID
    string
    default "MIMX9352xxxxM" if MCUX_HW_DEVICE_ID_MIMX9352xxxxM

config MCUX_HW_DEVICE_PART
    string
    default "MIMX9352DVVXM" if MCUX_HW_DEVICE_PART_MIMX9352DVVXM
    default "MIMX9352AVTXM" if MCUX_HW_DEVICE_PART_MIMX9352AVTXM
    default "MIMX9352CVVXM" if MCUX_HW_DEVICE_PART_MIMX9352CVVXM
    default "MIMX9352XVVXM" if MCUX_HW_DEVICE_PART_MIMX9352XVVXM

# ip information
config MCUX_HW_IP_DriverType_
    bool
    default y
    depends on MCUX_HW_DEVICE_ID_MIMX9352xxxxM

config MCUX_HW_IP_DriverType_AXBS
    bool
    default y
    depends on MCUX_HW_DEVICE_ID_MIMX9352xxxxM

config MCUX_HW_IP_DriverType_BLK_CTRL_NIC_WRAPPER
    bool
    default y
    depends on MCUX_HW_DEVICE_ID_MIMX9352xxxxM

config MCUX_HW_IP_DriverType_BLK_CTRL_WAKEUPMIX
    bool
    default y
    depends on MCUX_HW_DEVICE_ID_MIMX9352xxxxM

config MCUX_HW_IP_DriverType_CoreDebug
    bool
    default y
    depends on MCUX_HW_DEVICE_ID_MIMX9352xxxxM

config MCUX_HW_IP_DriverType_DDR
    bool
    default y
    depends on MCUX_HW_DEVICE_ID_MIMX9352xxxxM

config MCUX_HW_IP_DriverType_DWT
    bool
    default y
    depends on MCUX_HW_DEVICE_ID_MIMX9352xxxxM

config MCUX_HW_IP_DriverType_D_IP_MX9DUAL_CCM
    bool
    default y
    depends on MCUX_HW_DEVICE_ID_MIMX9352xxxxM

config MCUX_HW_IP_DriverType_EDMA3
    bool
    default y
    depends on MCUX_HW_DEVICE_ID_MIMX9352xxxxM

config MCUX_HW_IP_DriverType_ENET
    bool
    default y
    depends on MCUX_HW_DEVICE_ID_MIMX9352xxxxM

config MCUX_HW_IP_DriverType_ENET_QOS
    bool
    default y
    depends on MCUX_HW_DEVICE_ID_MIMX9352xxxxM

config MCUX_HW_IP_DriverType_ETM
    bool
    default y
    depends on MCUX_HW_DEVICE_ID_MIMX9352xxxxM

config MCUX_HW_IP_DriverType_FLEXCAN
    bool
    default y
    depends on MCUX_HW_DEVICE_ID_MIMX9352xxxxM

config MCUX_HW_IP_DriverType_FLEXIO
    bool
    default y
    depends on MCUX_HW_DEVICE_ID_MIMX9352xxxxM

config MCUX_HW_IP_DriverType_FLEXSPI
    bool
    default y
    depends on MCUX_HW_DEVICE_ID_MIMX9352xxxxM

config MCUX_HW_IP_DriverType_FPB
    bool
    default y
    depends on MCUX_HW_DEVICE_ID_MIMX9352xxxxM

config MCUX_HW_IP_DriverType_I3C
    bool
    default y
    depends on MCUX_HW_DEVICE_ID_MIMX9352xxxxM

config MCUX_HW_IP_DriverType_ISI
    bool
    default y
    depends on MCUX_HW_DEVICE_ID_MIMX9352xxxxM

config MCUX_HW_IP_DriverType_ITM
    bool
    default y
    depends on MCUX_HW_DEVICE_ID_MIMX9352xxxxM

config MCUX_HW_IP_DriverType_JTAGC
    bool
    default y
    depends on MCUX_HW_DEVICE_ID_MIMX9352xxxxM

config MCUX_HW_IP_DriverType_LCDIFV3
    bool
    default y
    depends on MCUX_HW_DEVICE_ID_MIMX9352xxxxM

config MCUX_HW_IP_DriverType_LPI2C
    bool
    default y
    depends on MCUX_HW_DEVICE_ID_MIMX9352xxxxM

config MCUX_HW_IP_DriverType_LPIT
    bool
    default y
    depends on MCUX_HW_DEVICE_ID_MIMX9352xxxxM

config MCUX_HW_IP_DriverType_LPSPI
    bool
    default y
    depends on MCUX_HW_DEVICE_ID_MIMX9352xxxxM

config MCUX_HW_IP_DriverType_LPTMR
    bool
    default y
    depends on MCUX_HW_DEVICE_ID_MIMX9352xxxxM

config MCUX_HW_IP_DriverType_LPUART
    bool
    default y
    depends on MCUX_HW_DEVICE_ID_MIMX9352xxxxM

config MCUX_HW_IP_DriverType_MCM
    bool
    default y
    depends on MCUX_HW_DEVICE_ID_MIMX9352xxxxM

config MCUX_HW_IP_DriverType_MECC256
    bool
    default y
    depends on MCUX_HW_DEVICE_ID_MIMX9352xxxxM

config MCUX_HW_IP_DriverType_MEMORY
    bool
    default y
    depends on MCUX_HW_DEVICE_ID_MIMX9352xxxxM

config MCUX_HW_IP_DriverType_MIPI_CSI
    bool
    default y
    depends on MCUX_HW_DEVICE_ID_MIMX9352xxxxM

config MCUX_HW_IP_DriverType_MIPI_DSI_4L
    bool
    default y
    depends on MCUX_HW_DEVICE_ID_MIMX9352xxxxM

config MCUX_HW_IP_DriverType_MQS
    bool
    default y
    depends on MCUX_HW_DEVICE_ID_MIMX9352xxxxM

config MCUX_HW_IP_DriverType_MU_1
    bool
    default y
    depends on MCUX_HW_DEVICE_ID_MIMX9352xxxxM

config MCUX_HW_IP_DriverType_OTFAD
    bool
    default y
    depends on MCUX_HW_DEVICE_ID_MIMX9352xxxxM

config MCUX_HW_IP_DriverType_PDM
    bool
    default y
    depends on MCUX_HW_DEVICE_ID_MIMX9352xxxxM

config MCUX_HW_IP_DriverType_PXP
    bool
    default y
    depends on MCUX_HW_DEVICE_ID_MIMX9352xxxxM

config MCUX_HW_IP_DriverType_RGPIO
    bool
    default y
    depends on MCUX_HW_DEVICE_ID_MIMX9352xxxxM

config MCUX_HW_IP_DriverType_S3MUA
    bool
    default y
    depends on MCUX_HW_DEVICE_ID_MIMX9352xxxxM

config MCUX_HW_IP_DriverType_SAI
    bool
    default y
    depends on MCUX_HW_DEVICE_ID_MIMX9352xxxxM

config MCUX_HW_IP_DriverType_SEMA42
    bool
    default y
    depends on MCUX_HW_DEVICE_ID_MIMX9352xxxxM

config MCUX_HW_IP_DriverType_SPDIF
    bool
    default y
    depends on MCUX_HW_DEVICE_ID_MIMX9352xxxxM

config MCUX_HW_IP_DriverType_SYS_CTR_COMPARE
    bool
    default y
    depends on MCUX_HW_DEVICE_ID_MIMX9352xxxxM

config MCUX_HW_IP_DriverType_SYS_CTR_CONTROL
    bool
    default y
    depends on MCUX_HW_DEVICE_ID_MIMX9352xxxxM

config MCUX_HW_IP_DriverType_SYS_CTR_READ
    bool
    default y
    depends on MCUX_HW_DEVICE_ID_MIMX9352xxxxM

config MCUX_HW_IP_DriverType_SysTick
    bool
    default y
    depends on MCUX_HW_DEVICE_ID_MIMX9352xxxxM

config MCUX_HW_IP_DriverType_TMU_3
    bool
    default y
    depends on MCUX_HW_DEVICE_ID_MIMX9352xxxxM

config MCUX_HW_IP_DriverType_TPIU
    bool
    default y
    depends on MCUX_HW_DEVICE_ID_MIMX9352xxxxM

config MCUX_HW_IP_DriverType_TPM
    bool
    default y
    depends on MCUX_HW_DEVICE_ID_MIMX9352xxxxM

config MCUX_HW_IP_DriverType_TRDC_1
    bool
    default y
    depends on MCUX_HW_DEVICE_ID_MIMX9352xxxxM

config MCUX_HW_IP_DriverType_TRGMUX
    bool
    default y
    depends on MCUX_HW_DEVICE_ID_MIMX9352xxxxM

config MCUX_HW_IP_DriverType_TSTMR
    bool
    default y
    depends on MCUX_HW_DEVICE_ID_MIMX9352xxxxM

config MCUX_HW_IP_DriverType_USDHC
    bool
    default y
    depends on MCUX_HW_DEVICE_ID_MIMX9352xxxxM

config MCUX_HW_IP_DriverType_WDOG32
    bool
    default y
    depends on MCUX_HW_DEVICE_ID_MIMX9352xxxxM

config MCUX_HW_IP_DriverType_blk_ctrl_ddrmix
    bool
    default y
    depends on MCUX_HW_DEVICE_ID_MIMX9352xxxxM

config MCUX_HW_IP_DriverType_blk_ctrl_mlmix
    bool
    default y
    depends on MCUX_HW_DEVICE_ID_MIMX9352xxxxM

config MCUX_HW_IP_DriverType_blk_ctrl_ns_aonmix
    bool
    default y
    depends on MCUX_HW_DEVICE_ID_MIMX9352xxxxM

config MCUX_HW_IP_DriverType_blk_ctrl_s_aonmix
    bool
    default y
    depends on MCUX_HW_DEVICE_ID_MIMX9352xxxxM

config MCUX_HW_IP_DriverType_iomuxc
    bool
    default y
    depends on MCUX_HW_DEVICE_ID_MIMX9352xxxxM

config MCUX_HW_IP_DriverType_uSDHC
    bool
    default y
    depends on MCUX_HW_DEVICE_ID_MIMX9352xxxxM

config MCUX_HW_IP_DriverType_SAR_ADC
    bool
    default y
    depends on MCUX_HW_DEVICE_ID_MIMX9352xxxxM
```

## i.MX93/MIMX9352/cm33/Kconfig
```kconfig
# Copyright 2025 NXP
#
# SPDX-License-Identifier: BSD-3-Clause

config MCUX_HW_DEVICE_MIMX9352_CORE_ID_cm33
    bool
    default y

rsource "Kconfig.chip"
```

## i.MX93/MIMX9352/cm33/Kconfig.chip
```kconfig
# Copyright 2025 NXP
#
# SPDX-License-Identifier: BSD-3-Clause

# core related
config MCUX_HW_CORE
    string
    default "cm33"

config MCUX_HW_CORE_CM33
    bool
    default y

config MCUX_HW_CORE_ID
    string
    default "cm33"

config MCUX_HW_CORE_ID_CM33
    bool
    default y

config MCUX_HW_DEVICE_CORE
    string
    default "MIMX9352_cm33"

config MCUX_HW_FPU
    string
    default "SP_FPU"

config MCUX_HW_FPU_TYPE
    string
    default "fpv5_sp"

config MCUX_HW_FPV5_SP
    bool
    default y

config MCUX_HW_INT_PRIO_BITS
    int
    default 3

config MCUX_HW_DSP
    bool
    default y

config MCUX_HW_SAU
    bool
    default y

config MCUX_HW_SOC_SERIES_MIMX
    bool
    default y

config MCUX_HW_SOC_SINGLECORE_DEVICE
    bool
    default y

config MCUX_HW_IP_DriverType_XCACHE
    bool
    default y
    depends on MCUX_HW_DEVICE_ID_MIMX9352xxxxM
    select MCUX_COMPONENT_driver.cache_xcache

# For chipmodel generated files
config MCUX_TOOLCHAIN_LINKER_DEVICE_PREFIX
    string
    default "MIMX9352xxxxM" if MCUX_HW_DEVICE_ID_MIMX9352xxxxM

config MCUX_TOOLCHAIN_MCUX_STARTUP
    string
    default "mimx9352"

# Toolchain related

config MCUX_TOOLCHAIN_IAR_CPU_IDENTIFIER
    string
    default "MIMX9352_M33" if MCUX_HW_DEVICE_ID_MIMX9352xxxxM

config MCUX_TOOLCHAIN_MDK_CPU_IDENTIFIER
    string
    default "MIMX9352DVVXM" if MCUX_HW_DEVICE_PART_MIMX9352DVVXM
    default "MIMX9352AVTXM" if MCUX_HW_DEVICE_PART_MIMX9352AVTXM
    default "MIMX9352CVVXM" if MCUX_HW_DEVICE_PART_MIMX9352CVVXM
    default "MIMX9352XVVXM" if MCUX_HW_DEVICE_PART_MIMX9352XVVXM
```

## i.MX937/MIMX9371/drivers/Kconfig
```kconfig
# Copyright 2026 NXP
# All rights reserved.
#
# SPDX-License-Identifier: BSD-3-Clause

rsource "../../../i.MX/i.MX937/MIMX9375/drivers/Kconfig"
```

## i.MX93W/MIMX93W32/drivers/Kconfig
```kconfig
# Copyright 2026 NXP
#
# SPDX-License-Identifier: BSD-3-Clause

rsource "../../../i.MX93W/MIMX93W52/drivers/Kconfig"
```

## i.MX93W/MIMX93W52/drivers/Kconfig
```kconfig
# Copyright 2026 NXP
#
# SPDX-License-Identifier: BSD-3-Clause

menu "Device specific drivers configuration"

    config MCUX_COMPONENT_driver.clock
         bool "clock"
         default y

    config MCUX_COMPONENT_driver.edma_soc
         bool "edma_soc"
         default n

    config MCUX_COMPONENT_driver.iomuxc
         bool "iomuxc"
         default y

    config MCUX_COMPONENT_driver.memory
         bool "memory"
         default y

    config MCUX_COMPONENT_driver.misc_soc
         bool "misc_soc"
         default n

    config MCUX_COMPONENT_driver.sentinel
         bool "sentinel"
         default n

    config MCUX_COMPONENT_driver.mipi_dsi_soc
         bool "soc_mipi_dsi_soc"
         default n

    config MCUX_COMPONENT_driver.trdc_soc
         bool "trdc_soc"
         default n

endmenu
```

## i.MX943/MIMX94398/Kconfig
```kconfig
# Copyright 2024 NXP
#
# SPDX-License-Identifier: BSD-3-Clause
rsource "${core_id}/Kconfig"

rsource "Kconfig.chip"
rsource "drivers/Kconfig"
rsource "../../../arm/Kconfig.common"
rsource "Kconfig.defconfig"
rsource "Kconfig.rpmsg"

## pinmux dependency
config MCUX_DEPENDENCY_PINMUX
    bool
    default n

    imply MCUX_COMPONENT_driver.rgpio
    imply MCUX_COMPONENT_driver.port

## Project segment and component dependency data
config MCUX_HW_DEVICE_MIMX94398
    # bool "Device MIMX94398 Configuration"
    bool
    default y
    ## Project segment dependency data

    imply  MCUX_COMPONENT_driver.irqsteer_1
    imply  MCUX_COMPONENT_driver.sramctl
    select MCUX_COMPONENT_driver.port if MCUX_PRJSEG_module.board.pinmux
    select MCUX_COMPONENT_driver.rgpio if MCUX_PRJSEG_module.board.pinmux
    select MCUX_COMPONENT_driver.clock if MCUX_PRJSEG_module.board.clock
    select MCUX_COMPONENT_component.lpuart_adapter if MCUX_PRJSEG_module.board.console_lite
    select MCUX_COMPONENT_driver.lpuart if MCUX_PRJSEG_module.board.console_lite

    # component dependency
```
